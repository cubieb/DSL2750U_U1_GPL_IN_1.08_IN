## RTL8676xx/src/opensource/l2tpd/Config.in
```kconfig
config OPENSOURCE_L2TPD
	bool 'l2tpd'
	default n
	depends on OPENSOURCE
  	help 
      	l2tpd
```

## RTL8676xx/src/opensource/libnetfilter_conntrack/Config.in
```kconfig
#####################
config OPENSOURCE_LIBNETFILTER_CONNTRACK
	bool 'libnetfilter_conntrack'
	default y
	depends on OPENSOURCE
  	help 
      	libnetfilter_conntrack-0.0.89 
```

## RTL8676xx/src/opensource/libnfnetlink/Config.in
```kconfig
#####################
config OPENSOURCE_LIBNFNETLINK
	bool 'libnfnetlink'
	default y
	depends on OPENSOURCE
  	help 
      	libnfnetlink-0.0.33
```

## RTL8676xx/src/opensource/libpng/Config.in
```kconfig
config OPENSOURCE_LIB_PNG
	bool 'libpng'
	default n
	depends on OPENSOURCE
	help
	Enable libpng
```

## RTL8676xx/src/opensource/mld/Config.in
```kconfig
config OPENSOURCE_MLD
	bool 'MLD Proxy & Snooping'
	default y
	depends on OPENSOURCE && TBS_SUPPORT_IPV6
	help
	mld proxy & Snooping daemon
```

## RTL8676xx/src/opensource/msntp/Config.in
```kconfig
############config for msntp######################################
config OPENSOURCE_MSNTP
	bool 'MSNTP'
	default n
	depends on OPENSOURCE
	help
	Mini Simple Network Time Protocol for time synchronization

##################################################################
```

## RTL8676xx/src/opensource/nanocom/Config.in
```kconfig
#####################
config OPENSOURCE_NANOCOM
	bool 'Nanocom for 3g sim card AT code'
	default y
	depends on OPENSOURCE
  	help 
		This program is used to send AT code to 3G sim card.
```

## RTL8676xx/src/opensource/ntfs/Config.in
```kconfig
config OPENSOURCE_NTFS
	bool 'NTFS'
	default n
	depends on OPENSOURCE
	help
	Enable NTFS filesystem
```

## RTL8676xx/src/opensource/openssl/Config.in
```kconfig
#####################
menuconfig OPENSOURCE_OPENSSL
  bool "OpenSSL"
  depends on OPENSOURCE 

choice
  prompt "OpenSSL Version"
  default OPENSOURCE_OPENSSL_097
  depends on OPENSOURCE_OPENSSL
  help
    There are 2 version Openssl 0.9.7 and 0.9.8
    0.9.7 has smaller size,but not support WAPI
    0.9.7 EAPTLS can support hostapd with EAPTLS
    0.9.8 has bigger size,can support WAPI 
 

config OPENSOURCE_OPENSSL_097
  bool "0.9.7"

config OPENSOURCE_OPENSSL_097_EAPTLS
  bool "0.9.7(with EAP/TLS)"

config OPENSOURCE_OPENSSL_098 
  bool "0.9.8(WAPI)"

endchoice
```

## RTL8676xx/src/opensource/peanuthullclient/Config.in
```kconfig
#####################
config OPENSOURCE_PEANUTHULLCLIENT
	bool 'PeanutHull Client(peanuthullc)'
	default n
	depends on OPENSOURCE
  	help 
		peanuthull client
```

## RTL8676xx/src/opensource/ping/Config.in
```kconfig
#####################
config OPENSOURCE_PING
	bool 'ping'
	default y
	depends on OPENSOURCE
  	help 
		ping
```

## RTL8676xx/src/opensource/ppp-pppoe/Config.in
```kconfig
#####################
config OPENSOURCE_PPPD
	bool 'PPP Daemom'
	default y
	depends on OPENSOURCE
  	help 
      	PPP Daemom

config OPENSOURCE_PPPD_SUPPORT_IPV6
	bool 'support ipv6cp'
	default n
	depends on OPENSOURCE_PPPD
	help
	
```

## RTL8676xx/src/opensource/pptp/Config.in
```kconfig
config OPENSOURCE_PPTP
	bool 'pptp'
	default n
	depends on OPENSOURCE
  	help 
      	pptp
```

## RTL8676xx/src/opensource/qrencode/Config.in
```kconfig
config OPENSOURCE_QRENCODE
	bool 'QrenCode'
	default n
	depends on OPENSOURCE
	help
	QrenCode
```

## RTL8676xx/src/opensource/radvd/Config.in
```kconfig
#####################
config OPENSOURCE_RADVD
	bool 'radvd'
	depends on OPENSOURCE
  	help 
      Router Advertisement Daemon for IPv6 Stateless Address Autoconfiguration

config OPENSOURCE_RADVDUMP
	bool 'radvdump'
	depends on OPENSOURCE_RADVD
	help
	  dump router advertisements
	  
```

## RTL8676xx/src/opensource/samba/Config.in
```kconfig
config OPENSOURCE_SAMBA
        bool 'SAMBA'
        default n
        depends on OPENSOURCE
        help
	for NAS Application.
```

## RTL8676xx/src/opensource/siproxd/Config.in
```kconfig
config OPENSOURCE_SIPROXD
        bool 'sip proxy Daemon'
        default n
        depends on OPENSOURCE
        help
	 sip proxy base on sip Protocol.
```

## RTL8676xx/src/opensource/snmp/Config.in
```kconfig
config OPENSOURCE_SNMPA
        bool 'SNMPAgent'
        default y
        depends on OPENSOURCE
        help
        SNMP agent (snmpd) from Net-SNMP.

config ZTE_HOT_AP_SNMP_TRAP
		bool 'ZTE_HOT_AP_SNMP_IF'
		default y
		depends on OPENSOURCE_SNMPA
		help
		ZTE private trap .
		
config TBS_SNMP_APP
		bool 'TBS_SNMP_APP'
		default y
		depends on OPENSOURCE_SNMPA
		help
		tw private trap .

config OPENSOURCE_SNMPA_ENTERPRISE_OID
		string "Enterprise OID"
		default "33003"
                depends on OPENSOURCE_SNMPA
                help
                  Enterprise OID, default OID 33003 belongs to TWSZ.		
config OPENSOURCE_SNMPA_PRIVATE_WLAN
		bool 'PrivateWLAN'
		default y 
		depends on OPENSOURCE_SNMPA
		help
		WLan nodes for tbs wireless.

 
config OPENSOURCE_SNMPA_PUBLIC_NODES
		bool 'PublicNodes'
		default n
		depends on OPENSOURCE_SNMPA
		help
		Public nodes come from net-snmp itself.
		
config OPENSOURCE_STREAMRATE
		bool 'Adslrate'
		default y
		depends on OPENSOURCE_SNMPA
		help
		ADSL TRANSLATE RATE CONTRL.
```

## RTL8676xx/src/opensource/tcpdump/Config.in
```kconfig
#####################
config OPENSOURCE_TCPDUMP
	bool 'TCP DUMP'
	default n
	depends on OPENSOURCE_DEBUGTOOLS
  	help 
      	TCP DUMP
```

## RTL8676xx/src/opensource/ttcp/Config.in
```kconfig
#####################
config OPENSOURCE_TTCP
	bool 'TTCP'
	default n
	depends on OPENSOURCE_DEBUGTOOLS
  	help 
      	ttcp throughput test
```

## RTL8676xx/src/opensource/udhcp/Config.in
```kconfig
#####################
config OPENSOURCE_UDHCP
	bool 'UDHCP Server(udhcpd)'
	default y
	depends on OPENSOURCE
  	help 
		uDHCPd is a DHCP server geared primarily toward embedded systems,
		while striving to be fully functional and RFC compliant
```

## RTL8676xx/src/opensource/updatedd/Config.in
```kconfig
#####################
config OPENSOURCE_UPDATEDD
	bool 'Updatedd'
	default y
	depends on OPENSOURCE
  	help 
      	Dynamic DNS
```

## RTL8676xx/src/opensource/upnp/Config.in
```kconfig
#####################
menuconfig OPENSOURCE_UPnP
	bool 'UPnP'
	default y
	depends on OPENSOURCE
  	help 
      	UPnP IGD 
choice
	prompt "Miniupnpd Version"
	default OPENSOURCE_UPnP_15
	depends on OPENSOURCE && OPENSOURCE_UPnP
	help
	UPnP version

config OPENSOURCE_UPnP_12
	bool 'miniupnpd-1.2'
	depends on OPENSOURCE_UPnP
  	help 
      	miniupnpd-1.2 
      	
config OPENSOURCE_UPnP_15
	bool 'miniupnpd-1.5'
	depends on OPENSOURCE_UPnP
  	help 
      	miniupnpd-1.5
endchoice
```

## RTL8676xx/src/opensource/wireless_tools/Config.in
```kconfig
#####################
config OPENSOURCE_WIRELESS_TOOLS
	bool 'Wireless tools'
	default y 
	depends on OPENSOURCE
	help 
      	Enable wireless tools related WLAN 
```

## RTL8676xx/src/opensource/wpa_supplicant-0.5.5/Config.in
```kconfig
#####################
config OPENSOURCE_SUPPLICANT
	bool 'SUPPLICANT'
	default y
	depends on OPENSOURCE && APPS_LOGIC_WLAN
	help 
      	Enable wpa_supplicant related WLAN 
```
