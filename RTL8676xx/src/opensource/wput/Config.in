## RTL8676xx/src/opensource/wput/Config.in
```kconfig
config OPENSOURCE_WPUT
        bool 'WPUT'
        default n
        depends on OPENSOURCE
        help
        WPUT:ftp upload tool.
```

## RTL8676xx/src/opensource/xmlparser/Config.in
```kconfig
#####################
config OPENSOURCE_XMLPASER
	bool 'XML Paser(expat & scew)'
	default y
	depends OPENSOURCE
  	help 
      	Xml Paser (expat & scew)
```

## RTL8676xx/src/opensource/zebra/Config.in
```kconfig
#####################
config OPENSOURCE_ZEBRA
	bool 'zebra'
	default y 
	depends on OPENSOURCE
  	help 
      	ZEBRA 
```

## RTL8676xx/src/vendor/Config.in
```kconfig
######################################
#
#
######################################
menuconfig VENDOR
  bool "Vendor Applications"
  default y


#
#TBS-TAG:by ouyangdi 2008-11-29
#

source vendor/realtek/Config.in
```

## RTL8676xx/src/vendor/atheros/Config.in
```kconfig
######################################
#
#
######################################
menuconfig VENDOR_ATHERNOS 
  bool "Athernos Applications"
  depends on VENDOR
  default y

config VENDOR_ATHERNOS_HOSTAPD_CFG
	bool 'HOSTAPD_CFG'
	default y
	depends on VENDOR_ATHERNOS
  	help 
        athernos hostapd cfg cli tool	
  
```

## RTL8676xx/src/vendor/ikanos/Config.in
```kconfig
menuconfig VENDOR_IKANOS 
  bool "IKANOS Applications"
  depends on VENDOR
  default n

config IKANOS_DSL_APP
	bool 'IKANOS dsl app'
	default y
	depends on IKANOS_DSL_DRIVERS && VENDOR_IKANOS
	help
		IKANOS dsl app

#
# FUSIV Source User Configuration
#
menu "FUSIV Source User Configuration"
	depends on IKANOS_DSL_APP

source vendor/ikanos/sysutil/Config.in

choice
	depends on FUSIV_VX180
	prompt "Select xDSL type"
	default FUSIV_USER_VDSLD_UNIFIED

config FUSIV_USER_VDSLD_VX180
        bool "Generic VDSL mode only"
        help
           Generic VDSL code (fusiv_src/user/vdsld_vx180)

config FUSIV_USER_VDSLD_UNIFIED
        bool "IFE5 VDSL mode"
        help
           IFE5 VDSL code (fusiv_src/user/dsld/ife5).

config FUSIV_USER_AVDSLD
        bool "IFE6 AVDSL mode"
        help
           IFE6 AVDSL code (fusiv_src/user/dsld/ife6).
endchoice

config FUSIV_USER_VDSLD        
        bool "VDSL daemon for Alaska"
		depends on !(CONFIG_FUSIV_VX180)
        default n

endmenu
```

## RTL8676xx/src/vendor/ikanos/sysutil/Config.in
```kconfig
config BR2_PACKAGE_ADI_SYSUTILS
	bool "ikanos sysutils"
	default n
	depends on IKANOS_DSL_APP
	help
	  ADI sysutils.

config USER_SYSUTIL_APREADWRITE
	bool "AP Read/Write"
	depends on BR2_PACKAGE_ADI_SYSUTILS
	default n
	help
	    Utility to Read from or Write to Fusiv AP.

config USER_SYSUTIL_MREADWRITE
	bool "Memory Read/Write"
	depends on BR2_PACKAGE_ADI_SYSUTILS
	default n
	help
	    Utility to Read from or Write to Memory.

config USER_SYSUTIL_APSTATS
	bool "AP Statistics"
	depends on BR2_PACKAGE_ADI_SYSUTILS
	default n
	help
	    Utility to retrieve Fusiv AP statistics.

config USER_SYSUTIL_APROUTETABLE
	bool "AP Route Table"
	depends on BR2_PACKAGE_ADI_SYSUTILS
	default n
	help
	    Utility to display Fusiv AP Route Table.

config USER_SYSUTIL_ADSLUTILS
	bool "ADSL Utilities"
	depends on BR2_PACKAGE_ADI_SYSUTILS
	default n
	help
	    Provides various ADSL Utilities like adsl start, adsl mon, etc.

config USER_SYSUTIL_XDSL_LINE_MNGR
	bool "XDSL Line Manager"
	depends on BR2_PACKAGE_ADI_SYSUTILS
	default n
	help
	    xDSL Line auto detection

config USER_SYSUTIL_SENDOAMLB
	bool "OAM Loopback"
	depends on BR2_PACKAGE_ADI_SYSUTILS
	default n
	help
	    Utility to initiate OAM Loopback.

config USER_SYSUTIL_SHOWATMCONN
	bool "Show ATM Connections"
	depends on BR2_PACKAGE_ADI_SYSUTILS
	default n
	help
	    Utility to view configured PVC's.

config USER_SYSUTIL_GETRMON
        bool "Get Ethernet RMON counters"
        depends on BR2_PACKAGE_ADI_SYSUTILS
        default n
        help
            Utility to Get Ethernet RMON Counters.

config USER_SYSUTIL_GETLINK
	bool "Get Link State"
	depends on BR2_PACKAGE_ADI_SYSUTILS
	default n
	help
	    Utility to Get Ethernet Link State.

config USER_SYSUTIL_SETLINK
	bool "Set Link State"
	depends on BR2_PACKAGE_ADI_SYSUTILS
	default n
	help
	    Utility to Set Ethernet Link State.

config USER_ADI_PPPOE_RELAY
        bool "pppoe-relay"
        depends on BR2_PACKAGE_ADI_SYSUTILS
        default n
        help
            to relay pppoe packets through the target board.

config USER_SYSUTIL_IGMPSNOOP
        bool "IGMP SNOOP"
        depends on BR2_PACKAGE_ADI_SYSUTILS
        default n
        help
            Utility to configure IGMP Snooping.

config USER_SYSUTIL_POLICY_VLAN
        bool "Policy based VLAN"
        depends on BR2_PACKAGE_ADI_SYSUTILS
        default n
        help
            Utility to configure add/delete policy based vlan.
config USER_SYSUTIL_SWITCH_CONFIG
        bool "Configuration FOR IC+ SWITCH"
        depends on BR2_PACKAGE_ADI_SYSUTILS
        default n
        help
            Utility to configure Vlan/Qos for IC+ Switch.

config USER_SYSUTIL_APQOS
  bool "QoS Configurations Utility"
  depends on BR2_PACKAGE_ADI_SYSUTILS
  default n
  help
     Utility to Configure QoS Parameters for AP.

config USER_SYSUTIL_SRM
        bool "Save/Restore"
        default y
        help
        Utility to save/restore the configured information.

config USER_SYSUTIL_GPON
        bool "GPON CLI"
        default n
        help
        Utility to set/get  config information.

config USER_SYSUTIL_COMPDECOMP
        bool "Zlib Compression/Decompression"
        default n
        help
        Utility for Compressing/Decompressing files using zlib.

config USER_SYSUTIL_SET_ETH_FRAME_READ_CNT
        bool "Maximum Ethernet Frame Read Count"
        default n
        help
        Utility for configuring the max ethernet frame read cnt.

config USER_SYSUTIL_SET_ATM_FRAME_READ_CNT
        bool "Maximum ATM Frame Read Count"
        default n
        help
        Utility for configuring the max ATM frame read cnt.

config USER_SYSUTIL_SET_PERI_FRAME_READ_CNT
        bool "Maximum PERI_AP Frame Read Count"
        default n
        help
        Utility for configuring the max PERI_AP frame read cnt.

config USER_SYSUTIL_SET_VDSL_FRAME_READ_CNT
        bool "Maximum VDSL Frame Read Count"
        default n
        help
        Utility for configuring the max VDSL frame read cnt.
```

## RTL8676xx/src/vendor/infineon/Config.in
```kconfig
menuconfig VENDOR_INFINEON 
  bool "Infineon Applications"
  depends on VENDOR
  default n

config INFINEON_DSL_APP
	bool 'Infineon dsl app'
	default y
	depends on INFINEON_DSL_DRIVERS && VENDOR_INFINEON
	help
		Infineon dsl app
```

## RTL8676xx/src/vendor/ralink/Config.in
```kconfig
menuconfig VENDOR_RALINK 
  bool "Ralink Applications"
  depends on VENDOR
  default n

config RALINK_RT2860APD_APP
	bool 'Ralink rt2860apd app'
	default y
	depends on VENDOR_RALINK
	help
		Ralink rt2860adp app
```

## RTL8676xx/src/vendor/realtek/Config.in
```kconfig
menuconfig VENDOR_REALTEK 
  bool "Realtek Applications"
  depends on VENDOR
  default n

config REALTEK_AUTH_APP
	bool 'Realtek Auth app'
	default y
	depends on VENDOR_REALTEK
	help
		Realtek Auth app

config REALTEK_FLASH_TOOLS
	bool 'Realtek Flash Tools'
	default y
	depends on VENDOR_REALTEK
	help
		Realtek Flash Tools
		
config USER_WIRELESS_TOOLS_AUTH
	bool 'Realtek wireless tools'
	default y
	depends on VENDOR_REALTEK
	help
		Realtek wireless tools

config REALTEK_ADSL_APP
	bool "Realtek adsl config tool"
	default y
	depends on VENDOR_REALTEK
	help
		Realtek adsl app

config REALTEK_SAR_APP
	bool "Realtek sar config tool"
	default y
	depends on VENDOR_REALTEK
	help
		Realtek sar configuration application

config REALTEK_ATM_APP
	bool "Realtek atm(br2684) config tool(EOA and IPOA)"
	default y
	depends on VENDOR_REALTEK
	help
		Realtek atm app

config REALTEK_ADSL_START 
	bool "start rtl8672 adsl"
	default y
	depends on VENDOR_REALTEK
	help
		start rtl8672 adsl pid
		
config REALTEK_WPS_APP
	bool "Realtek WPS config tool"
	default y
	depends on VENDOR_REALTEK && APPS_LOGIC_WPS
	help
		Realtek WSC
		
config REALTEK_WPS2X_APP
	bool "Realtek WPS2X config tool"
	default y
	depends on VENDOR_REALTEK && APPS_LOGIC_WPS
	help
		Realtek WSC_2.0
		
config REALTEK_NET_LOGGER
	bool "Realtek netlogger"
	default y
	depends on VENDOR_REALTEK
	help
		Realtek netlogger

config REALTEK_USB_TEST
	bool "Realtek USB test tool"
	default n
	depends on VENDOR_REALTEK
	help
		Realtek USB test tool
```

## customer/apps/html/Config.in
```kconfig
######################################
config APPS_OTHERPORT
	bool 'OTHERPORT'
	default n
	depends on APPS
	select APPS_WEB
  	help
      	  Visit the webpage through other ports
config APPS_HTML
	bool 'HTML'
	default y
	depends on APPS
	select APPS_WEB
	#select APPS_HTML_PAGE_system_msg
  	help
      	  HTML Pages
######################################
menu "Languages"
	depends on APPS_HTML

	menu "All Supported Languages"
		depends on APPS_HTML

		config APPS_HTML_LANG_SUPPORT_en_us
			bool 'English'
			default y
			help
				Support English Language.

		config APPS_HTML_LANG_SUPPORT_zh_cn
			bool 'Chinese'
			default y
			help
				Support Chinese Language.

		config APPS_HTML_LANG_SUPPORT_es_es
			bool 'Spanish'
			default n
			help
				Support Spanish Language.
	endmenu

	choice
		prompt "Default language"
		default APPS_HTML_LANG_DEFAULT_zh_cn
		depends on APPS_HTML

		config APPS_HTML_LANG_DEFAULT_en_us
			bool 'English'
			select APPS_HTML_LANG_SUPPORT_en_us
			help
				English as default language.

		config APPS_HTML_LANG_DEFAULT_zh_cn
			bool 'Chinese'
			select APPS_HTML_LANG_SUPPORT_zh_cn
			help
				Chinese as default language.

		config APPS_HTML_LANG_DEFAULT_es_es
			bool 'Spanish'
			select APPS_HTML_LANG_SUPPORT_es_es
			help
				Spanish as default language.
	endchoice



endmenu
######################################
menu "Web Style"
	depends on APPS_HTML
	choice
		prompt "All Supported Style"
		default APPS_HTML_WEB_STYLE_Blue
		depends on APPS_HTML
		config APPS_HTML_WEB_STYLE_STANDARD
			bool 'standard'
			help
				Web  Standard  style
		config APPS_HTML_WEB_STYLE_DSL2740EL
			bool 'DSL2740EL'
			help
				Web  DSL2740EL  style		
		config APPS_HTML_WEB_STYLE_DSL2750U
			bool 'DSL2750U'
			help
				Web  DSL2750U  style		
		config APPS_HTML_WEB_STYLE_DSL2730U
			bool 'DSL2730U'
			help
				Web  DSL2730U  style	
		config APPS_HTML_WEB_STYLE_DSL2730U_ETISALAT
			bool 'DSL2730U_ETISALAT'
			help
				Web DSL2730U Etisalat style
		config APPS_HTML_WEB_STYLE_DSL2750U_ETISALAT
			bool 'DSL2750U_ETISALAT'
			help
				Web DSL2750U Etisalat style
		config APPS_HTML_WEB_STYLE_DSL2730E
			bool 'DSL2730E'
			help
				Web  DSL2730E  style			
		config APPS_HTML_WEB_STYLE_DSL2750E
			bool 'DSL2750E'
			help
				Web  DSL2750E  style		
		config APPS_HTML_WEB_STYLE_DSL2750E_TOT
			bool 'DSL2750E_TOT'
			help
				Web  DSL2750E_TOT  style			
	endchoice
	
	choice
		prompt "Default Style"
		default APPS_HTML_WEB_STYLE_DEFAULT_Blue
		depends on APPS_HTML

	  config APPS_HTML_WEB_STYLE_DEFAULT_STANDARD
			bool 'standard'
			help
				Web  Standard  style
    config APPS_HTML_WEB_STYLE_DEFAULT_DSL2740EL
    	    bool 'DSL2740EL'
    	    help
    		web DSL2740EL stype 
    config APPS_HTML_WEB_STYLE_DEFAULT_DSL2750U
    	    bool 'DSL2750U'
    	    help
    		web DSL2750U stype      		 							
    config APPS_HTML_WEB_STYLE_DEFAULT_DSL2730U
    	    bool 'DSL2730U'
    	    help
    		web DSL2730U stype      		 							
    config APPS_HTML_WEB_STYLE_DEFAULT_DSL2730U_ETISALAT
    	    bool 'DSL2730U_ETISALAT'
    	    help
    		web DSL2730U Etisalat stype
    config APPS_HTML_WEB_STYLE_DEFAULT_DSL2750U_ETISALAT
    	    bool 'DSL2750U_ETISALAT'
    	    help
    		web DSL2750U Etisalat stype
     config APPS_HTML_WEB_STYLE_DEFAULT_DSL2750E_TOT
    	    bool 'DSL2750E_TOT'
    	    help
    		web DSL2750E_TOT stype

	endchoice
	
	config APPS_HTML_WEB_LOGIN_WIZARD
			bool 'telefonica login wizard'
			default n
			help
				 telefonica's request when logging in the CPE ,  pop out a specific wizard page
				 
	
endmenu
```
