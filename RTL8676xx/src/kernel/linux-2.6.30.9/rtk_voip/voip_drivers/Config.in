## RTL8676xx/src/opensource/Config.in
```kconfig
menuconfig OPENSOURCE
        bool "Open Source"
        default y

#source opensource/xmlpaser/Config.in
source opensource/busybox/Config.in
source opensource/brctl/Config.in
source opensource/openssl/Config.in
source opensource/httpd/Config.in
source opensource/ppp-pppoe/Config.in
source opensource/ipsec/Config.in
source opensource/dproxy/Config.in
source opensource/iptables/Config.in
source opensource/ebtables/Config.in
source opensource/atm/Config.in
source opensource/ethtool/Config.in
source opensource/udhcp/Config.in
source opensource/dhcpv6/Config.in
source opensource/radvd/Config.in
source opensource/updatedd/Config.in
source opensource/inadyn/Config.in
source opensource/dhcpr/Config.in
source opensource/libnfnetlink/Config.in
source opensource/libnetfilter_conntrack/Config.in
source opensource/igmpproxy/Config.in
source opensource/mld/Config.in
source opensource/l2tpd/Config.in
source opensource/pptp/Config.in
source opensource/snmp/Config.in
source opensource/iproute2/Config.in
source opensource/dropbear/Config.in
source opensource/zebra/Config.in
source opensource/msntp/Config.in
source opensource/ping/Config.in
source opensource/bftpd/Config.in
source opensource/ftpd/Config.in
source opensource/ippd/Config.in
source opensource/samba/Config.in
source opensource/ntfs/Config.in
source opensource/upnp/Config.in
source opensource/hostapd-0.4.8/Config.in
source opensource/wpa_supplicant-0.5.5/Config.in
source opensource/wireless_tools/Config.in
source opensource/siproxd/Config.in
source opensource/nanocom/Config.in
source opensource/peanuthullclient/Config.in
source opensource/dlna/Config.in
source opensource/libpng/Config.in
source opensource/qrencode/Config.in
source opensource/fon/Config.in
source opensource/wput/Config.in
menuconfig OPENSOURCE_DEBUGTOOLS 
        bool "Debug Tools"
        default n
        depends on OPENSOURCE
        help
        Debug Tools

if OPENSOURCE_DEBUGTOOLS=y
source opensource/tcpdump/Config.in
source opensource/ttcp/Config.in
source opensource/gdb/Config.in
endif
```

## RTL8676xx/src/opensource/atm/Config.in
```kconfig
config OPENSOURCE_ATM
	bool '2684 interface config tool(EOA and IPOA)'
	default y
	depends on OPENSOURCE
  	help 
	  	
```

## RTL8676xx/src/opensource/bftpd/Config.in
```kconfig
config OPENSOURCE_BFTPD
	bool 'FTP UpGrader'
	default y
	depends on OPENSOURCE
	help
	Enable external ftpupgrader
```

## RTL8676xx/src/opensource/brctl/Config.in
```kconfig
#####################
config OPENSOURCE_BRCTL
	bool 'Bridge utils'
	default y
	depends on OPENSOURCE
  	help 
      	Bridge utils
```

## RTL8676xx/src/opensource/busybox/Config.in
```kconfig
menuconfig OPENSOURCE_BUSYBOX
	bool 'BusyBox'
	default y
	depends on OPENSOURCE
	help 
      	Busy Box

if OPENSOURCE_BUSYBOX=y
	source opensource/busybox/busybox-1.6.1/Config.in.main
endif
```

## RTL8676xx/src/opensource/dhcpr/Config.in
```kconfig
#####################
config OPENSOURCE_DHCPR
	bool 'DHCP Relay(dhcp-fwd)'
	default y
	depends on OPENSOURCE
  	help 
		This program is used to forward DHCP and BOOTP messages 
		between two networks with different broadcast domains.
```

## RTL8676xx/src/opensource/dhcpv6/Config.in
```kconfig
menuconfig OPENSOURCE_DHCPV6
		bool 'dhcpv6'
        default n
        depends on OPENSOURCE
        help
        dhcp server, client and realy for ipv6

config OPENSOURCE_DHCPV6_SERVER
		bool 'dhcpv6_server'
		depends on OPENSOURCE_DHCPV6
		help

config OPENSOURCE_DHCPV6_CLIENT
		bool 'dhcpv6_client'
		depends on OPENSOURCE_DHCPV6
		help
		
```

## RTL8676xx/src/opensource/dlna/Config.in
```kconfig
#####################
config OPENSOURCE_DLNA
	bool 'Support DLNA'
	default y 
	depends on OPENSOURCE
  	help 
      	Support DMS(DLNA)

choice
  prompt "DLNA Version"
  default OPENSOURCE_DLNA_BCM
  depends on OPENSOURCE_DLNA
  help
    There are 3 version DLNA intel and broadcom
    dlna_intel 
    dlna_usb 
    dlna_bcm  
 
config OPENSOURCE_DLNA_INTEL
  bool "Intel version"

config OPENSOURCE_DLNA_USB
  bool "Broadcom usb version"

config OPENSOURCE_DLNA_BCM
  bool "Broadcom version"

endchoice
```

## RTL8676xx/src/opensource/dproxy/Config.in
```kconfig
#####################
config OPENSOURCE_DPROXY
	bool 'Dproxy'
	default y
	depends on OPENSOURCE
  	help 
      	Dproxy for DNS Relay & Caching nameserver 
```

## RTL8676xx/src/opensource/dropbear/Config.in
```kconfig
#####################
config OPENSOURCE_DROPBEAR
	bool 'DropBear SSH Server'
	default n 
	depends on OPENSOURCE
  	help 
      	DropBear SSH Server 
```

## RTL8676xx/src/opensource/ebtables/Config.in
```kconfig
menuconfig OPENSOURCE_EBTABLES
	bool 'ebtables'
	default y
	depends on OPENSOURCE
  	help
        ebtables

menuconfig OPENSOURCE_EB_2_0_6
	bool 'ebtables version 2.0.6'
	default n
	depends on OPENSOURCE_EBTABLES
	help
		ebtables version 2.0.6

if OPENSOURCE_EB_2_0_6=y
source opensource/ebtables/Config.in.2.0.6
endif

menuconfig OPENSOURCE_EB_2_0_9
 	bool 'ebtables version 2.0.9-2'
	default n
	depends on OPENSOURCE_EBTABLES
	help
		ebtables version 2.0.9-2
		
if OPENSOURCE_EB_2_0_9=y
source opensource/ebtables/Config.in.2.0.9
endif
```

## RTL8676xx/src/opensource/ethtool/Config.in
```kconfig
#####################
config OPENSOURCE_ETHTOOL
	bool 'Eth tool'
	default y
	depends on OPENSOURCE
  	help 
      	ETH Tool
```

## RTL8676xx/src/opensource/fon/Config.in
```kconfig
config OPENSOURCE_FON
        bool 'FON'
        default n
        depends on OPENSOURCE
        help
        FON.
```

## RTL8676xx/src/opensource/ftpd/Config.in
```kconfig
config OPENSOURCE_FTPD
        bool 'FTP Daemon'
        default n
        depends on OPENSOURCE
        help
	FTP Server, a file-level data storage (such as USB storage class) connected to a network 
	providing data access to heterogeneous network clients.
```

## RTL8676xx/src/opensource/gdb/Config.in
```kconfig
#####################
config OPENSOURCE_GDB
	bool 'Cross GDB for debug only'
	default n 
	depends on OPENSOURCE
  	help 
      	GDB 

config OPENSOURCE_GDB_SERVER
	bool 'GDB Server for debug only'
	default y
	depends on OPENSOURCE_GDB
  	help 
      	GDB Server
```

## RTL8676xx/src/opensource/hostapd-0.4.8/Config.in
```kconfig
#####################
config OPENSOURCE_HOSTAPD
	bool 'HOSTAPD'
	default y
	depends on OPENSOURCE && APPS_LOGIC_WLAN
	help 
      	Enable hostapd related WLAN 
```

## RTL8676xx/src/opensource/httpd/Config.in
```kconfig
#####################
config OPENSOURCE_HTTPD
	bool 'HTTP Server(Web Server)'
	default n
	depends on OPENSOURCE
	help 
      	Enable external httpd

config OPENSOURCE_HTTPD_SSL
	bool 'Support SSL(https)'
	default n
	depends on (OPENSOURCE_HTTPD && OPENSOURCE_OPENSSL)
	help 
      	Enable HTTPS,need OPENSSL

config OPENSOURCE_HTTPD_IPV6
	bool 'Support IPV6'
	default n
	depends on OPENSOURCE_HTTPD
	help
		Enable mini-httpd to support IPV6
```

## RTL8676xx/src/opensource/igmp-proxy/Config.in
```kconfig
#####################
config OPENSOURCE_IGMPPROXY
	bool 'IGMP Proxy'
	default y
	depends OPENSOURCE
  	help 
      	IGMPProxy for IGMP Proxy
```

## RTL8676xx/src/opensource/igmpproxy/Config.in
```kconfig
#####################
config OPENSOURCE_IGMPPROXYV3
	bool 'IGMPProxy'
	default y
	depends on OPENSOURCE
  	help 
      	IGMPproxy is a simple mulitcast router for Linux that only uses the IGMP protocol.

config SUPPORT_IGMP_V3
	bool 'Support IGMPv3'
	default n
	depends on OPENSOURCE_IGMPPROXYV3
	help
		Support IGMPv3

config SUPPORT_MULTIWAN 
	bool 'Support multiwan upstream'
	default n
	depends on OPENSOURCE_IGMPPROXYV3
	help
		Support multi wan upstream

	
```

## RTL8676xx/src/opensource/inadyn/Config.in
```kconfig
#####################
config OPENSOURCE_INADYN_MT
	bool 'inadyn-mt'
	default y
	depends on OPENSOURCE
  	help 
      	Dynamic DNS
```

## RTL8676xx/src/opensource/ippd/Config.in
```kconfig
config OPENSOURCE_IPPD
        bool 'IPP Daemon'
        default n
        depends on OPENSOURCE
        help
	USB Printing Server base on IPP Protocol.

config OPENSOURCE_LP_FIRMWARE
        tristate 'Printer Firmware'
        default n
        depends on OPENSOURCE
        help
	USB Printer Firmware.

config OPENSOURCE_LP_FW_HP1020
        bool "HP1020 Firmware(128,663 Bytes)"
        depends on OPENSOURCE_LP_FIRMWARE

config OPENSOURCE_LP_FW_HPP1008
        bool "HPp1008 Firmware(222,571 Bytes)"
        depends on OPENSOURCE_LP_FIRMWARE
```

## RTL8676xx/src/opensource/iproute2/Config.in
```kconfig
menuconfig OPENSOURCE_IPROUTE2
        bool 'iproute2'
        default y
        depends on OPENSOURCE
        help
        iproute2, provide tc and ip command tool.

######################################################
menuconfig OPENSOURCE_IP_UTIL
		bool 'ip'
		default y
		depends on OPENSOURCE_IPROUTE2
		help

config OPENSOURCE_IP_LINK
		bool 'ip link'
		default n
		depends on OPENSOURCE_IP_UTIL
		help

config OPENSOURCE_IP_ADDR
		bool 'ip addr'
		default n
		depends on OPENSOURCE_IP_UTIL
		help

config OPENSOURCE_IP_RT_TAB
		bool 'ip route'
		default y
		depends on OPENSOURCE_IP_UTIL
		help

config OPENSOURCE_IP_RT_RULE
		bool 'ip rule'
		default y
		depends on OPENSOURCE_IP_UTIL
		help

config OPENSOURCE_IP_TUNNEL
		bool 'ip tunnel'
		default y
		depends on OPENSOURCE_IP_UTIL
		help

config OPENSOURCE_IP_NEIGH
		bool 'ip neigh'
		default n
		depends on OPENSOURCE_IP_UTIL
		help

config OPENSOURCE_IP_NTAB
		bool 'ip ntable'
		default n
		depends on OPENSOURCE_IP_UTIL
		help 

config OPENSOURCE_IP_MADDR
		bool 'ip maddr'
		default n
		depends on OPENSOURCE_IP_UTIL
		help

config OPENSOURCE_IP_MROUTE
		bool 'ip mroute'
		default n
		depends on OPENSOURCE_IP_UTIL
		help

config OPENSOURCE_IP_MONITOR 
		bool 'ip monitor'
		default n
		depends on OPENSOURCE_IP_UTIL
		help

config OPENSOURCE_IP_XFRM
		bool 'ip xfrm'
		default n
		depends on OPENSOURCE_IP_UTIL
		help
 
######################################################################
menuconfig OPENSOURCE_TC_UTIL
		bool 'tc'
		default y
		depends on OPENSOURCE_IPROUTE2
		help


comment "Queueing/Scheduling"
depends on OPENSOURCE_TC_UTIL

config OPENSOURCE_TC_QSFQ
        bool 'SFQ'
        default y
        depends on OPENSOURCE_TC_UTIL
        help
        
config OPENSOURCE_TC_QTBF
        bool 'TBF'
        default n
        depends on OPENSOURCE_TC_UTIL
        help

config OPENSOURCE_TC_QFIFO
        bool 'FIFO'
        default y
        depends on OPENSOURCE_TC_UTIL && OPENSOURCE_TC_QPRIO
        help

config OPENSOURCE_TC_QPRIO
        bool 'PRIO'
        default y
        depends on OPENSOURCE_TC_UTIL
        help 

config OPENSOURCE_TC_QCBQ
        bool 'CBQ'
        default n
        depends on OPENSOURCE_TC_UTIL
        help

config OPENSOURCE_TC_QRED
        bool 'RED'
        default n
        depends on OPENSOURCE_TC_UTIL
        help

config OPENSOURCE_TC_QGRED
        bool 'GRED'
        default n
        depends on OPENSOURCE_TC_UTIL
        help     

config OPENSOURCE_TC_QHTB   
        bool 'HTB'
        default y
        depends on OPENSOURCE_TC_UTIL
        help

config OPENSOURCE_TC_QDSMARK   
        bool 'DSMARK'
        default n
        depends on OPENSOURCE_TC_UTIL
        help

config OPENSOURCE_TC_QINGRESS
        bool 'INGRESS'
        default n
        depends on OPENSOURCE_TC_UTIL
        help

config OPENSOURCE_TC_QHFSC
        bool 'HFSC'
        default n
        depends on OPENSOURCE_TC_UTIL
        help
        
config OPENSOURCE_TC_QNETEM
        bool 'NETEM'
        default n
        depends on OPENSOURCE_TC_UTIL
        help

config OPENSOURCE_TC_QATM
		bool 'ATM'
		default n
		depends on OPENSOURCE_TC_UTIL
		help

#######################################################
comment "Classification"
depends on OPENSOURCE_TC_UTIL

config OPENSOURCE_TC_FBASIC
        bool 'BASIC'
        default n
        depends on OPENSOURCE_TC_UTIL && OPENSOURCE_TC_EMATCH
        help
        
config OPENSOURCE_TC_FU32
        bool 'U32'
        default n
        depends on OPENSOURCE_TC_UTIL
        help

config OPENSOURCE_TC_FROUTE
        bool 'ROUTE'
        default n
        depends on OPENSOURCE_TC_UTIL
        help
        
config OPENSOURCE_TC_FFW
        bool 'FW'
        default y
        depends on OPENSOURCE_TC_UTIL
        help
        
config OPENSOURCE_TC_FTCINDEX
        bool 'TCINDEX'
        default n
        depends on OPENSOURCE_TC_UTIL
        help
        
config OPENSOURCE_TC_FRSVP
        bool 'RSVP'
        default n
        depends on OPENSOURCE_TC_UTIL
        help        
###########################################
menuconfig OPENSOURCE_TC_EMATCH
        bool 'Extended Matches'
        default n
        depends on OPENSOURCE_TC_UTIL
        help

config OPENSOURCE_TC_EM_CMP
        bool 'Simple packet data comparison'
        default n
        depends on OPENSOURCE_TC_EMATCH
        help

config OPENSOURCE_TC_EM_NBYTE
        bool 'Multi byte comparison'
        default n
        depends on OPENSOURCE_TC_EMATCH
        help

config OPENSOURCE_TC_EM_U32
        bool 'U32 key'
        default n
        depends on OPENSOURCE_TC_EMATCH
        help

config OPENSOURCE_TC_EM_META
        bool 'Metadata'
        default n
        depends on OPENSOURCE_TC_EMATCH
        help
        
###########################################
menuconfig OPENSOURCE_TC_ACT
        bool "Actions"
        default n
        depends on OPENSOURCE_TC_UTIL
		#select OPENSOURCE_TC_ESTIMATOR
        help

config OPENSOURCE_TC_ACT_POLICE
		bool "Traffic policing"
		depends on OPENSOURCE_TC_ACT
		help
        
config OPENSOURCE_TC_ACT_GACT
        bool 'Generic actions'
        default n
        depends on OPENSOURCE_TC_ACT
        help

config OPENSOURCE_TC_ACT_MIRRED
        bool 'Redirecting and Mirroring'
        default n
        depends on OPENSOURCE_TC_ACT
        help
        
config OPENSOURCE_TC_ACT_IPT
        bool 'IPtables targets'
        default n
        depends on OPENSOURCE_TC_ACT
        help
        
config OPENSOURCE_TC_ACT_PEDIT
        bool 'Packet Editing'
        default n
        depends on OPENSOURCE_TC_ACT
        help

#########################################
config OPENSOURCE_TC_ACT_PEDIT_IP
        bool 'ipv4/v6 header'
        default n
        depends on OPENSOURCE_TC_ACT_PEDIT

config OPENSOURCE_TC_ACT_PEDIT_TCP
        bool 'tcp header'
        default n
        depends on OPENSOURCE_TC_ACT_PEDIT
        
config OPENSOURCE_TC_ACT_PEDIT_UDP
        bool 'udp header'
        default n
        depends on OPENSOURCE_TC_ACT_PEDIT

config OPENSOURCE_TC_ACT_PEDIT_ICMP
        bool 'icmp header'
        default n
        depends on OPENSOURCE_TC_ACT_PEDIT

#############################################
config OPENSOURCE_TC_POLICE
		bool 'traffic policing(deprecate)'
		depends on OPENSOURCE_TC_UTIL
		depends on OPENSOURCE_TC_ACT_POLICE != y
		#select OPENSOURCE_TC_ESTIMATOR
		help

config OPENSOURCE_TC_ESTIMATOR
		bool 'rate estimator'
		depends on OPENSOURCE_TC_UTIL
		help

config OPENSOURCE_TC_MONITOR
		bool 'Monitor'
		depends on OPENSOURCE_TC_UTIL
		help
```

## RTL8676xx/src/opensource/ipsec/Config.in
```kconfig
#####################
config OPENSOURCE_IPSEC
	bool 'ipsec (ipsec-tools)'
	default n
	depends on OPENSOURCE
  	help 
		This program is for IPsec VPN 
```
