## RTL8676xx/src/kernel/linux-2.6.30.9/arch/rlx/Kconfig
```kconfig
#
# Realtek Semiconductor Corp.
#
# RLX Linux Kernel Configuration
#
# Tony Wu (tonywu@realtek.com)
# Dec. 07, 2008
#

source "arch/rlx/bsp/Kconfig"
menu "Hardware Configuration"
config MIPS
    bool "mips"
    default y
#    select HAVE_OPROFILE
#    select HAVE_ARCH_KGDB

config TRAD_SIGNALS
    bool "TRAD_SIGNALS"
    default y

#
# 32BIT
#
config 32BIT
  bool "32BIT"
  default y

config BINFMT_ELF
  bool "BINFMT_ELF"
  default y

config SYS_SUPPORTS_32BIT_KERNEL
  bool "SYS_SUPPORTS_32BIT_KERNEL"
  default y

config CPU_SUPPORTS_32BIT_KERNEL
  bool "CPU_SUPPORTS_32BIT_KERNEL"
  default y

#
# CPU
#
config CPU_RLX4181
  bool "CPU_RLX4181"
  default y if ARCH_CPU_RLX4181

config CPU_RLX5181
  bool "CPU_RLX5181"
  default y if ARCH_CPU_RLX5181

config CPU_RLX5280
  bool "CPU_RLX5280"
  default y if ARCH_CPU_RLX5280

config CPU_RLX4281
  bool "CPU_RLX4281"
  default y if ARCH_CPU_RLX4281

config CPU_RLX5281
  bool "CPU_RLX5281"
  default y if ARCH_CPU_RLX5281

config CPU_HAS_RADIAX
  bool "CPU_HAS_RADIAX"
  default y if ARCH_CPU_RADIAX

config CPU_HAS_SLEEP
  bool "CPU_HAS_SLEEP"
  default y if ARCH_CPU_SLEEP

config CPU_HAS_ULS
  bool "CPU_HAS_ULS"
  default y if ARCH_CPU_ULS

config CPU_HAS_LLSC
  bool "CPU_HAS_LLSC"
  default y if ARCH_CPU_LLSC

config CPU_HAS_SYNC
  bool "CPU_HAS_SYNC"
  default y if ARCH_CPU_SYNC

config MMU
    bool "MMU"
    default y

config PAGE_SIZE_4KB
  bool "PAGE_SIZE_4KB"
  default y

#
# CPU may reorder R->R, R->W, W->R, W->W
# Reordering beyond LL and SC is handled in WEAK_REORDERING_BEYOND_LLSC
#
config WEAK_ORDERING
    bool "WEAK_ORDERING"

#
# CPU may reorder reads and writes beyond LL/SC
# CPU may reorder R->LL, R->LL, W->LL, W->LL, R->SC, R->SC, W->SC, W->SC
#
config WEAK_REORDERING_BEYOND_LLSC
    bool "WEAK_REORDERING_BEYOND_LLSC"

#
# CACHE
#
config CPU_HAS_WBC
  bool "CPU_HAS_WBC"
  default y if ARCH_CACHE_WBC

config CPU_HAS_L2C
  bool "CPU_HAS_L2C"
  default y if ARCH_CACHE_L2C

config CPU_HAS_WBIC
  bool "CPU_HAS_WBIC"
  default y if ARCH_CACHE_WBIC

#
# WRITE BUFFER
#
config CPU_HAS_WB
  bool "CPU has write buffer"
  default n

#
# DMA
#
config DMA_NONCOHERENT
  bool "DMA_NONCOHERENT"
  default y
  select DMA_NEED_PCI_MAP_STATE

config DMA_NEED_PCI_MAP_STATE
  bool "DMA_NEED_PCI_MAP_STATE"

config ZONE_DMA
  bool "ZONE_DMA"

config ZONE_DMA32
  bool "ZONE_DMA32"

#
# ENDIAN
#
config CPU_BIG_ENDIAN
  bool "CPU_BIG_ENDIAN"
	depends on !ARCH_CPU_EL

config CPU_LITTLE_ENDIAN
  bool "CPU_LITTLE_ENDIAN"
	depends on !ARCH_CPU_EB

#
# IRQ
#
config IRQ_CPU
  bool "IRQ_CPU"
  default y if ARCH_IRQ_CPU

config IRQ_VEC
  bool "IRQ_VEC"
  default y if ARCH_IRQ_VEC

config GENERIC_HARDIRQS
    bool "GENERIC_HARDIRQS"
    default y

config GENERIC_IRQ_PROBE
    bool "GENERIC_IRQ_PROBE"
    default y

config GENERIC_HARDIRQS_NO__DO_IRQ
    def_bool n

#
# BUS
#
config HW_HAS_PCI
  bool "Hardware has PCI bus"
  default y if ARCH_BUS_PCI

config ARCH_SUPPORTS_MSI
  bool "ARCH_SUPPORTS_MSI"
  default y if ARCH_BUS_PCI_MSI

config HW_HAS_USB
  bool "Hardware has USB bus"
  default y if ARCH_BUS_USB

#
# end of RLX configuration
#

config RWSEM_GENERIC_SPINLOCK
	bool "RWSEM_GENERIC_SPINLOCK"
	default y

config RWSEM_XCHGADD_ALGORITHM
	bool "RWSEM_XCHGADD_ALGORITHM"

config ARCH_SUPPORTS_OPROFILE
	bool "ARCH_SUPPORTS_OPROFILE"
	default y if !MIPS_MT_SMTC

config GENERIC_FIND_NEXT_BIT
	bool "GENERIC_FIND_NEXT_BIT"
	default y

config GENERIC_HWEIGHT
	bool "GENERIC_HWEIGHT"
	default y

config GENERIC_CALIBRATE_DELAY
	bool "GENERIC_CALIBRATE_DELAY"
	default y

config GENERIC_CLOCKEVENTS
	bool "GENERIC_CLOCKEVENTS"
	default y

config GENERIC_TIME
	bool "GENERIC_TIME"
	default y

config GENERIC_CMOS_UPDATE
	bool "GENERIC_CMOS_UPDATE"
	default n

config SCHED_OMIT_FRAME_POINTER
	bool "SCHED_OMIT_FRAME_POINTER"
	default y

#
# Select some configuration options automatically based on user selections.
#
config EARLY_PRINTK
	bool "Early printk" if EMBEDDED
	depends on SYS_HAS_EARLY_PRINTK
	default y
	help
	  This option enables special console drivers which allow the kernel
	  to print messages very early in the bootup process.

	  This is useful for kernel debugging when your machine crashes very
	  early before the console code is initialized. For normal operation,
	  it is not recommended because it looks ugly on some machines and
	  doesn't cooperate with an X server. You should normally say N here,
	  unless you want to debug such a crash.

config SYS_HAS_EARLY_PRINTK
	bool "System has early printk"

config NO_IOPORT
	def_bool n

config GENERIC_ISA_DMA
	bool "GENERIC_ISA_DMA"
	select ZONE_DMA if GENERIC_ISA_DMA_SUPPORT_BROKEN=n

config GENERIC_ISA_DMA_SUPPORT_BROKEN
	bool "GENERIC_ISA_DMA_SUPPORT_BROKEN"
	select GENERIC_ISA_DMA

config GENERIC_GPIO
	bool "GENERIC_GPIO"

config SWAP_IO_SPACE
	bool "SWAP_IO_SPACE"

#
# Set to y for ptrace access to watch registers.
#
config HARDWARE_WATCHPOINTS
       bool "HARDWARE_WATCHPOINTS"
       default y if CPU_MIPSR1 || CPU_MIPSR2

endmenu

menu "Kernel type"

#
# - Highmem only makes sense for the 32-bit kernel.
# - The current highmem code will only work properly on physically indexed
#   caches such as R3000, SB1, R7000 or those that look like they're virtually
#   indexed such as R4000/R4400 SC and MC versions or R10000.  So for the
#   moment we protect the user and offer the highmem option only on machines
#   where it's known to be safe.  This will not offer highmem on a few systems
#   such as MIPS32 and MIPS64 CPUs which may have virtual and physically
#   indexed CPUs but we're playing safe.
# - We use SYS_SUPPORTS_HIGHMEM to offer highmem only for systems where we
#   know they might have memory configurations that could make use of highmem
#   support.
#
config HIGHMEM
	bool "High Memory Support"
	depends on 32BIT && CPU_SUPPORTS_HIGHMEM && SYS_SUPPORTS_HIGHMEM

config CPU_SUPPORTS_HIGHMEM
	bool "CPU_SUPPORTS_HIGHMEM"

config SYS_SUPPORTS_HIGHMEM
	bool "SYS_SUPPORTS_HIGHMEM"

config ARCH_FLATMEM_ENABLE
	def_bool y

config ARCH_DISCONTIGMEM_ENABLE
	def_bool n

config ARCH_POPULATES_NODE_MAP
	def_bool y

config NODES_SHIFT
	int "NODES_SHIFT"
	default "6"
	depends on NEED_MULTIPLE_NODES

source "mm/Kconfig"

config SMP
    def_bool n

source "kernel/time/Kconfig"

#
# Timer Interrupt Frequency Configuration
#

choice
	prompt "Timer frequency"
	default HZ_250
	help
	 Allows the configuration of the timer frequency.

	config HZ_48
		bool "48 HZ" if SYS_SUPPORTS_48HZ || SYS_SUPPORTS_ARBIT_HZ

	config HZ_100
		bool "100 HZ" if SYS_SUPPORTS_100HZ || SYS_SUPPORTS_ARBIT_HZ

	config HZ_128
		bool "128 HZ" if SYS_SUPPORTS_128HZ || SYS_SUPPORTS_ARBIT_HZ

	config HZ_250
		bool "250 HZ" if SYS_SUPPORTS_250HZ || SYS_SUPPORTS_ARBIT_HZ

	config HZ_256
		bool "256 HZ" if SYS_SUPPORTS_256HZ || SYS_SUPPORTS_ARBIT_HZ

	config HZ_1000
		bool "1000 HZ" if SYS_SUPPORTS_1000HZ || SYS_SUPPORTS_ARBIT_HZ

	config HZ_1024
		bool "1024 HZ" if SYS_SUPPORTS_1024HZ || SYS_SUPPORTS_ARBIT_HZ

endchoice

config SYS_SUPPORTS_48HZ
	bool "SYS_SUPPORTS_48HZ"

config SYS_SUPPORTS_100HZ
	bool "SYS_SUPPORTS_100HZ"

config SYS_SUPPORTS_128HZ
	bool "SYS_SUPPORTS_128HZ"

config SYS_SUPPORTS_250HZ
	bool "SYS_SUPPORTS_250HZ"

config SYS_SUPPORTS_256HZ
	bool "SYS_SUPPORTS_256HZ"

config SYS_SUPPORTS_1000HZ
	bool "SYS_SUPPORTS_1000HZ"

config SYS_SUPPORTS_1024HZ
	bool "SYS_SUPPORTS_1024HZ"

config SYS_SUPPORTS_ARBIT_HZ
	bool "SYS_SUPPORTS_ARBIT_HZ"
	default y if !SYS_SUPPORTS_48HZ && !SYS_SUPPORTS_100HZ && \
		     !SYS_SUPPORTS_128HZ && !SYS_SUPPORTS_250HZ && \
		     !SYS_SUPPORTS_256HZ && !SYS_SUPPORTS_1000HZ && \
		     !SYS_SUPPORTS_1024HZ

config HZ
	int "Hz"
	default 48 if HZ_48
	default 100 if HZ_100
	default 128 if HZ_128
	default 250 if HZ_250
	default 256 if HZ_256
	default 1000 if HZ_1000
	default 1024 if HZ_1024

source "kernel/Kconfig.preempt"

config KEXEC
	bool "Kexec system call (EXPERIMENTAL)"
	depends on EXPERIMENTAL
	help
		kexec is a system call that implements the ability to shutdown your
		current kernel, and to start another kernel. It is like a reboot but 
		it is independent of the system firmware. And like a reboot you can 
		start any kernel with it, not just Linux. The name comes from the 
		similarity to the exec system call. It is an ongoing process to be 
		certain the hardware in a machine is properly shutdown, so do not 
		be surprised if this code does not initially work for you.  It may 
		help to enable device hotplugging support. As of this writing the 
		exact hardware interface is strongly in flux, so no good 
		recommendation can be made.

config SECCOMP
	bool "Enable seccomp to safely compute untrusted bytecode"
	depends on PROC_FS
	default y
	help
		This kernel feature is useful for number crunching applications 
		that may need to compute untrusted bytecode during their execution. 
		By using pipes or other transports made available to the process 
		as file descriptors supporting the read/write syscalls, it is 
		possible to isolate those applications in their own address space 
		using seccomp. Once seccomp is enabled via /proc/<pid>/seccomp, it 
		cannot be disabled and the task is only allowed to execute a few 
		safe syscalls defined by each seccomp mode. If unsure, say Y. 
		Only embedded should say N here.


config LOCKDEP_SUPPORT
	bool "LOCKDEP_SUPPORT"
	default y

config STACKTRACE_SUPPORT
	bool "STACKTRACE_SUPPORT"
	default n

endmenu
source "init/Kconfig"

source "kernel/Kconfig.freezer"

menu "PCI Bus options"

config PCI
	bool "Support for PCI controller"
	depends on HW_HAS_PCI
	select PCI_DOMAINS
	help
	  Find out whether you have a PCI motherboard. PCI is the name of a
	  bus system, i.e. the way the CPU talks to the other stuff inside
	  your box. Other bus systems are ISA, EISA, or VESA. If you have PCI,
	  say Y, otherwise N.

config PCI_DOMAINS
	bool "PCI_DOMAINS"

source "drivers/pci/Kconfig"
source "drivers/pci/hotplug/Kconfig"
source "drivers/pcmcia/Kconfig"

endmenu

menu "Power management options"

config ARCH_SUSPEND_POSSIBLE
	def_bool y
	depends on !SMP

source "kernel/power/Kconfig"

endmenu

source "net/Kconfig"
source "drivers/Kconfig"
source "fs/Kconfig"
source "arch/rlx/Kconfig.debug"
source "security/Kconfig"
source "crypto/Kconfig"
source "lib/Kconfig"
source "rtk_voip/Kconfig"
```

## RTL8676xx/src/kernel/linux-2.6.30.9/arch/rlx/bsp/Kconfig
```kconfig
#
# System Config
#
menu "System Configuration"
choice
	prompt "Chipset Configuration"
	default RTL8676
	
config RTL8676
	bool "Realtek RTL8676"
	help
	  This enables supports for RTL8676-based boards
endchoice

#config RTL_819X
#	def_bool y

#config RTL_8196C
#	def_bool y

#
# Processor Config
#
config ARCH_32BIT
  bool	"ARCH_32BIT" 
  default y

choice
        prompt "CPU hardware Arch"
        depends on RTL8676
        default ARCH_CPU_RLX5181

config ARCH_CPU_RLX5181
  bool "ARCH_CPU_RLX5181"
  depends on !RLE0412
  
config ARCH_CPU_RLX5281
  bool "ARCH_CPU_RLX5281"

endchoice
choice
        prompt "CPU Endianess"
        depends on RTL8676
        default ARCH_CPU_EB

config ARCH_CPU_EB
  bool "ARCH_CPU_EB"

config ARCH_CPU_EL
  bool "ARCH_CPU_EL"

endchoice

config ARCH_CPU_RADIAX
  bool "ARCH_CPU_RADIAX"
  default n

config ARCH_CPU_SLEEP
  bool "ARCH_CPU_SLEEP"
  default n

config ARCH_CPU_ULS
  bool "ARCH_CPU_ULS"
  default y

config ARCH_CPU_LLSC
  bool "ARCH_CPU_LLSC"
  default n

config ARCH_CPU_SYNC
  bool "ARCH_CPU_SYNC"
  default n

config ARCH_CACHE_WBC
  bool "ARCH_CACHE_WBC"
  default y

config ARCH_CACHE_L2
  bool "ARCH_CACHE_L2"
  default n

config ARCH_IRQ_CPU
  bool "ARCH_IRQ_CPU"
  default y

config ARCH_IRQ_VEC
  bool "ARCH_IRQ_VEC"
  default y

config ARCH_BUS_USB
  bool "ARCH_BUS_USB"
  default n

config ARCH_BUS_PCI
  bool "ARCH_BUS_PCI"
  default y

config ARCH_BUS_PCI_MSI
  bool "ARCH_BUS_PCI_MSI"
  default n

config RLE0412
	bool "Support for RLE0412"
	select ARCH_CPU_RLX5281
	select ARCH_CPU_SYNC
	default n

# KERNE_STACK_SIZE = PAGE_SIZE<<KERNEL_STACK_SIZE_ORDER
config KERNEL_STACK_SIZE_ORDER
	int "Kenel Stack Size Order Configuration"
	default "2"
	help
	  With Page Size 4K
	  1 for 8K kenel stack size
	  2 for 16K kernel stack size
	  3 for 32K kernel stack size
	  etc...

choice
        prompt "FLASH read type"
        default FLASH_PIO_READ

config FLASH_MMIO_READ
        boolean "CPU MMIO flash read support"

config FLASH_PIO_READ
        boolean "CPU PIO flash read support"

endchoice

choice
	prompt "Flash Size"
	depends on RTL8676
	default 4M_FLASH

config 2M_FLASH
	bool "2M"

config 4M_FLASH
	bool "4M"

config	8M_FLASH
	bool "8M"

config	16M_FLASH
	bool "16M"
endchoice

config SPANSION_16M_FLASH
	bool "Support for SPANSION 16M FLASH"
	depends on RTL8676

config 64KB_CONF_PART
	bool "Support a 64KB config partition for TR-069"
	depends on RTL8676 

config DEV_xDSL
	bool "xDsl device"
	default y
choice 
	prompt "xDSL Chip"
	default RTL8271BVN
	depends on DEV_xDSL

config RTL8271BVN
	boolean "RTL8271BVN QFN32"
	depends on DEV_xDSL


config RTL8271BVQ
	boolean "RTL8271BVQ LQFP48"
	depends on DEV_xDSL

endchoice

config EOC
	bool "Support for DSL EOC channel"
	depends on RTL8676 && DEV_xDSL

config E8B
	bool "Support for CTC E8B requirement"

config NEW_PORTMAPPING
    bool "Support the new port mapping"
    depends on E8B

choice	
	prompt "IMEM Size"
	depends on RTL8676
	default	IMEM_4K

config	IMEM_4K
	bool "4K"

config	IMEM_32K
	bool "32K"

config	IMEM_64K
	bool "64K"

endchoice

choice	
	prompt "IMEM1 Size"
	depends on ARCH_CPU_RLX5281
	default	IMEM1_32K

config	IMEM1_4K
	bool "4K"

config	IMEM1_32K
	bool "32K"

config	IMEM1_64K
	bool "64K"

endchoice

config IMEM_SIZE
	hex
	default "10000" if IMEM_64K
	default "8000" if IMEM_32K
	default "1000"
	
config IMEM1_SIZE
	hex
	default "10000" if IMEM1_64K
	default "8000" if IMEM1_32K
	default "1000"

#choice
#	prompt "LED Style"
#	depends on RTL8676 
#	default GPIO_LED_TR068
#	
config GPIO_LED_TR068
	bool "GPIO led style TR068"
	default y
#endchoice
#
config RTL8676_SW_USB_LED
	tristate "Support Software USB LED"
	depends on USB_RTL8676_SUPPORT

config SW_USB_LED0
	bool "Software USB LED 0"
	depends on RTL8676_SW_USB_LED

config SW_USB_LED1
        bool "Software USB LED 1"
        depends on RTL8676_SW_USB_LED

config	WPS_LED
	 bool "Support WPS LED"
	depends on WIFI_SIMPLE_CONFIG && RTL8676

choice
	prompt "UART selection"
	depends on RTL8676
	default USE_UART1 if (BOARD_006 || RLE0412)
	default USE_UART0

config USE_UART0
	bool "Use UART0"

config USE_UART1
	bool "Use UART1"
endchoice

config MEM_LIMITATION
        bool "Memory size limitation"
        default n
endmenu
```
