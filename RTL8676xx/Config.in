## RTL8676xx/src/kernel/linux-2.6.30.9/drivers/button/Kconfig
```kconfig
menuconfig BUTTON_CLASS
	bool "Buttons Support"
	help
	  Say Y to enable Buttons driver.

if BUTTON_CLASS

config TBS_BUTTON
	boolean "TBS Buttons"
	help
	Say yes to enable TBS Button driver framwork.

choice
	prompt "Button Trigger Mode"
	depends on TBS_BUTTON
	default BUTTON_TRIGGER_INTERRUPT

config BUTTON_TRIGGER_INTERRUPT
	boolean "Interrupt Mode"
	depends on TBS_BUTTON
	help
	Say yes if button device use interrupt mode

config BUTTON_TRIGGER_TIMER
        tristate "Polling Mode"
        depends on TBS_BUTTON
        help
        This option enable button timer trigger function.
endchoice

comment "Button device"

config BUTTON_AR7130
	tristate "Button support for the AR7130"
	depends on TBS_BUTTON && MACH_AR7100
	help
	  This option enables support for the buttons on AR7130.

config BUTTON_AMAZON_SE
	tristate "Button support for the Amazon-SE"
	depends on TBS_BUTTON && AMAZON_SE
	help
	  This option enables support for the buttons on Infineon Amazon-SE.

config BUTTON_RT3052
	tristate "Button support for the RT3052"
	depends on TBS_BUTTON && RALINK_RT3052
	help
	  This option enables support for the buttons on Ralink rt3052.

config BUTTON_VX180
	tristate "Button support for the VX180"
	depends on TBS_BUTTON && FUSIV_VX180
	help
	  This option enables support for the buttons on IKANOS Vx180.

config BUTTON_RTL8672
	tristate "Button support for the RTL8672"
	depends on TBS_BUTTON && RTL8672
	help
	  This option enables support for the buttons on Realtek RTL8672.

config BUTTON_RTL8676
	tristate "Button support for the RTL8676"
	depends on TBS_BUTTON && RTL8676
	help
	  This option enables support for the buttons on Realtek RTL8672.

endif
```

## RTL8676xx/src/kernel/linux-2.6.30.9/drivers/net/wireless/rtl8192cd/Kconfig
```kconfig
config NET_WIRELESS_AGN
        bool
        depends on RTL8192CD
        default y
config	RTL8190_PRIV_SKB
	bool "private skb buffer management"
	depends on RTL8192CD
	default y
config  RTL_VAP_SUPPORT
    bool "VAP support"
	depends on RTL8192CD
config RTL_WDS_SUPPORT
        bool "WDS Support"
        depends on RTL8192CD
        default n
config	RTL_WAPI_SUPPORT
	bool "WAPI support"
	depends on RTL8192CD
config	RTL_WAPI_LOCAL_AS_SUPPORT
	bool	"support local AS"
	depends on RTL_WAPI_SUPPORT
config  RTL_TX_RESERVE_DESC
        bool "TX desc reserving mechanism"
        depends on RTL8192CD
        default y
config	ENABLE_EFUSE
	bool "Efuse Support"
	depends on RTL8192CD
	default y
config ENABLE_RX_BUFFER_GATHER
	bool "Enable RX buffer gather machanism"
	depends on RTL8192CD
	default n
config DISABLE_BR_SHORTCUT
	bool "Disable bridge shortcut function"
	depends on RTL8192CD
	default y
config PCIE_POWER_SAVING
	bool "Enable PCIE power saving support"
	depends on RTL8192CD
	default n
config Telefonica_Argentina
	bool "Telefonica_Argentina feature"
	depends on RTL8192CD
	default n
```

## RTL8676xx/src/kernel/linux-2.6.30.9/net/vnet/Kconfig
```kconfig
#
# Configuration for 802.1Q VLAN support
#

config VNET
	tristate "WAN VNET Support"
	default n
	---help---
	  Select this and you will be able to create WAN VNET interfaces
	  
```
