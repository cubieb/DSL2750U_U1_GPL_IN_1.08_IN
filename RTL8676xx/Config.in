## RTL8676xx/src/kernel/linux-2.6.30.9/rtk_voip/Kconfig
```kconfig
#
# VoIP driver configuration
#
#
#

menu "RTK VoIP Suite"
	depends on RTL_89xxC || RTL8672

	# rock: for Makefile to distinguish 2.4/2.6
	config DEFAULTS_KERNEL_2_6
	def_bool y

	config VOIP_COP3_PROFILE
		bool
		default y
	
	config VOIP_SDK
		bool
		default y
	config	RTK_VOIP_DSP
		bool
	config	RTK_VOIP_DRIVERS
		bool
	config	RTK_VOIP_RX
		bool
	config	RTK_VOIP_TX
		bool
	config	RTK_VOIP_MANAGER
		bool

	config RTK_VOIP_BOARD
		prompt "Use VoIP emulation board"
		bool 
		default y

	if RTK_VOIP_BOARD

		# support wideband DSP 
		config RTK_VOIP_WIDEBAND_SUPPORT
			bool
			default y
	
		config RTK_VOIP_PACKAGE_865X
			bool
		config RTK_VOIP_PACKAGE_867X
			bool
		config RTK_VOIP_PACKAGE_8186
			bool
		
		# ---------------------------------------------------------------------
		# Platform 
		
		choice
			prompt "VoIP Platform"
			default RTK_VOIP_DRIVERS_PCM8972B_FAMILY
		
			config RTK_VOIP_DRIVERS_PCM89xxC
				depends on RTL_8198
				bool "Platform(RTL8954C/RTL896xC)"
				select RTK_VOIP_RX
				select RTK_VOIP_TX
				select RTK_VOIP_PACKAGE_8186
		
			config RTK_VOIP_DRIVERS_PCM8972B_FAMILY
				depends on RTL8196B && !RTL_8198
				bool "Platform(RTL8972B/RTL898xB)"
				select RTK_VOIP_RX
				select RTK_VOIP_TX
				select RTK_VOIP_PACKAGE_8186
			
			config	RTK_VOIP_DRIVERS_PCM8671
				bool "Realtek 8671 board support PCM8671"
				depends on !RTL8196B && !RTL_8198
				select RTK_VOIP_RX
				select RTK_VOIP_TX
				select RTK_VOIP_PACKAGE_867X

			config RTK_VOIP_DRIVERS_PCM8672
				bool "Platform(RTL8672)"
				depends on !RTL8196B && !RTL_8198
				select RTK_VOIP_RX
				select RTK_VOIP_TX
				select RTK_VOIP_PACKAGE_867X
		endchoice
		
		if RTK_VOIP_GPIO_8672_VQD01
		choice
			prompt "GPIO Pin Definition Select"
			depends on RTK_VOIP_DRIVERS_PCM8672
			default 6166_IAD_SILAB3217X
			config  6166_IAD_SILAB3217X
				bool "RTL8672 RL6166 with Silab Si3217x Pin Definition"
				depends on RTK_VOIP_DRIVERS_SLIC_SILAB
			config  6166_IAD_ZARLINK
				bool "RTL8672 RL6166 with Zarlink V890 Pin Definition"
				depends on RTK_VOIP_DRIVERS_SLIC_ZARLINK
			config  6028_IAD_BGA_PIN_DEF
				bool "RTL8672 RL6028 356 BGA Pin Definition"
		endchoice

		choice
			prompt "SPI selection"
			depends on RTK_VOIP_DRIVERS_PCM8672
			
			config RTK_VOIP_8672_SPI_GPIO
				depends on RTK_VOIP_DRIVERS_PCM8672 && ( 6166_IAD_SILAB3217X || 6166_IAD_ZARLINK || 6028_IAD_BGA_PIN_DEF)
				bool "GPIO simulated SPI"
			config RTK_VOIP_8672_SHARED_SPI
				depends on RTK_VOIP_DRIVERS_PCM8672 && (6166_IAD_SILAB3217X || 6166_IAD_ZARLINK || 6028_IAD_BGA_PIN_DEF)
				bool "Real SPI"
		endchoice
		endif


		# ---------------------------------------------------------------------
		# SoC selection 
		
		choice
			prompt "SoC type"
			default RTK_VOIP_DRIVERS_PCM8972B_
			depends on RTK_VOIP_DRIVERS_PCM8972B_FAMILY || RTK_VOIP_DRIVERS_PCM89xxC
		
			config RTK_VOIP_DRIVERS_PCM8972B_
				depends on RTK_VOIP_DRIVERS_PCM8972B_FAMILY
				bool "RTL8972B"
			
			config RTK_VOIP_DRIVERS_PCM8981B_
				depends on RTK_VOIP_DRIVERS_PCM8972B_FAMILY
				bool "RTL8981B"
			
			config RTK_VOIP_DRIVERS_PCM8982B_
				depends on RTK_VOIP_DRIVERS_PCM8972B_FAMILY
				bool "RTL8982B"
			
			config RTK_VOIP_DRIVERS_PCM8984B_
				depends on RTK_VOIP_DRIVERS_PCM8972B_FAMILY
				bool "RTL8984B"
		
			config RTK_VOIP_DRIVERS_PCM8954C_
				depends on RTK_VOIP_DRIVERS_PCM89xxC
				bool "RTL8954C"

			config RTK_VOIP_DRIVERS_PCM8961C_
				depends on RTK_VOIP_DRIVERS_PCM89xxC
				bool "RTL8961C"

			config RTK_VOIP_DRIVERS_PCM8962C_
				depends on RTK_VOIP_DRIVERS_PCM89xxC
				bool "RTL8962C"

			config RTK_VOIP_DRIVERS_PCM8964C_
				depends on RTK_VOIP_DRIVERS_PCM89xxC
				bool "RTL8964C"
		endchoice

		# ---------------------------------------------------------------------
		# GPIO selection 
		
		comment "EV_Board GPIO Pin Selection"
		choice
			prompt "EV_Board version"
			#depends on RTK_VOIP_DRIVERS_ATA_SLIC || RTK_VOIP_DRIVERS_ATA_DECT || \
			#			RTK_VOIP_ETHERNET_DSP_IS_HOST
			default RTK_VOIP_GPIO_8954C_V400
			
			config	RTK_VOIP_GPIO_8672_VQD01
				bool "8672_VQD01"
				depends on RTK_VOIP_DRIVERS_PCM8672
			config	RTK_VOIP_GPIO_8671_V1_2
				bool "8671_V1.2"
				depends on RTK_VOIP_DRIVERS_PCM8671
			config	RTK_VOIP_GPIO_8671_V1_2_EMI
				bool "8671_V1.2_EMI"
				depends on RTK_VOIP_DRIVERS_PCM8671
			config	RTK_VOIP_GPIO_8671_QA_V1_1_V1_1_2_
				bool "8671_QA_V1.1_V1.1.2.2"
				depends on RTK_VOIP_DRIVERS_PCM8671
			config	RTK_VOIP_GPIO_8186PV_V275
				bool "8186PV_V275"
				depends on RTK_VOIP_DRIVERS_PCM8186
			config	RTK_VOIP_GPIO_8186V_V100_V200_V210
				bool "8186V_ALL"
				depends on RTK_VOIP_DRIVERS_PCM8186
			config	RTK_VOIP_GPIO_8651B
				bool "8651B"
				depends on RTK_VOIP_DRIVERS_PCM8651
			config	RTK_VOIP_GPIO_8982B_QA
				bool "RTL8982B_QA/Demo"
				depends on RTK_VOIP_DRIVERS_PCM8972B_FAMILY
				#select RTK_VOIP_865xC_QOS
				#select RTK_VOIP_WAN_VLAN
			config RTK_VOIP_GPIO_8972B
				bool "RTL8972B_VoIP_V100"
				depends on RTK_VOIP_DRIVERS_PCM8972B_FAMILY
				#select RTK_VOIP_QOS
				select RTK_VOIP_QOS_HEAVYLOAD
				#select RTK_VOIP_WAN_VLAN
			config	RTK_VOIP_GPIO_8964C_QA
				bool "RTL8964C_QA"
				depends on RTK_VOIP_DRIVERS_PCM89xxC
				#select RTK_VOIP_865xC_QOS
				#select RTK_VOIP_WAN_VLAN
			config RTK_VOIP_GPIO_8954C_V100
				bool "RTL8954C_V100"
				depends on RTK_VOIP_DRIVERS_PCM89xxC
				#select RTK_VOIP_QOS
				#select RTK_VOIP_WAN_VLAN
			config RTK_VOIP_GPIO_8954C_V200
				bool "RTL8954C_V200"
				depends on RTK_VOIP_DRIVERS_PCM89xxC
				#select RTK_VOIP_QOS
			config RTK_VOIP_GPIO_8954C_V400
				bool "RTL8954C_V400"
				depends on RTK_VOIP_DRIVERS_PCM89xxC
				#select RTK_VOIP_QOS
		endchoice
		
		choice
			prompt "EV_Board version"
			depends on RTK_VOIP_DRIVERS_IP_PHONE
			default RTK_VOIP_GPIO_IPP_8972B_V00
		
			config RTK_VOIP_GPIO_IPP_100
				bool "IPP_100"
			
			config RTK_VOIP_GPIO_IPP_8972B_V00
				bool "IPP_8972B_V00"
				depends on RTK_VOIP_DRIVERS_PCM8972B_FAMILY
				select RTK_VOIP_QOS
				select RTK_VOIP_QOS_HEAVYLOAD
			
			config RTK_VOIP_GPIO_IPP_8972B_V99
				bool "IPP_8972B_V99"
				depends on RTK_VOIP_DRIVERS_PCM8972B_FAMILY
				select RTK_VOIP_QOS
				select RTK_VOIP_QOS_HEAVYLOAD
		endchoice
		
		# ---------------------------------------------------------------------
		# GPIO selection - induce options 
		
		config RTK_VOIP_8954C_TEST_CHIP
			bool
			default y if ( RTK_VOIP_GPIO_8964C_QA || RTK_VOIP_GPIO_8954C_V100 )

	endif #RTK_VOIP_BOARD



	config RTK_VOIP
		depends on RTK_VOIP_BOARD
		tristate "RTK_VOIP Support"
		help
		  VoIP help
		select RTK_VOIP_DSP
		select RTK_VOIP_DRIVERS
		select RTK_VOIP_MANAGER
		#select VOIP_SDK


	if RTK_VOIP
		# ---------------------------------------------------------------------
		# Ethernet DSP 
		
		config RTK_VOIP_ETHERNET_DSP
			depends on RTK_VOIP_DRIVERS_PCM8972B_FAMILY || RTK_VOIP_DRIVERS_PCM89xxC
			bool "Ethernet DSP"
		
		choice 
			prompt "Ethernet DSP Type"
			depends on RTK_VOIP_ETHERNET_DSP
			default RTK_VOIP_ETHERNET_DSP_IS_HOST
		
			config RTK_VOIP_ETHERNET_DSP_IS_HOST
				bool "HOST"
			
			config RTK_VOIP_ETHERNET_DSP_IS_DSP
				bool "DSP"
				select RTL_NFBI_MDIO
		
		endchoice
		
		config NFBI_HOST
			bool "NFBI Host Driver"
			default y
			depends on RTK_VOIP_ETHERNET_DSP_IS_HOST && RTK_VOIP_DRIVERS_PCM89xxC 
			
		config RTL_NFBI_MDIO
			bool
		
		config RTK_VOIP_DSP_DEVICE_NR
			int "Number of DSP Device"
			range 1 4
			depends on RTK_VOIP_ETHERNET_DSP_IS_HOST
		
		config RTK_VOIP_SLIC_CH_NR_PER_DSP
			int "SLIC Channel Number Per DSP Device"
			range 1 8
			depends on RTK_VOIP_ETHERNET_DSP_IS_HOST
		
		config RTK_VOIP_DAA_CH_NR_PER_DSP
			int "DAA Channel Number Per DSP Device"
			range 0 8
			default 0
			depends on RTK_VOIP_ETHERNET_DSP_IS_HOST
		
		config RTK_VOIP_ETHERNET_DSP_IS_HOST_WITH_DAA_
			bool
			default y if RTK_VOIP_DAA_CH_NR_PER_DSP != 0
			depends on RTK_VOIP_ETHERNET_DSP_IS_HOST
			select RTK_VOIP_DRIVERS_FXO
			select RTK_VOIP_DRIVERS_DAA_SUPPORT			
		
		# ---------------------------------------------------------------------
		# GPIO selection - on/off options 
		
		config RTK_VOIP_LED
			bool "Support FXS/FXO LED (GPIO)"
			default y 
			depends on ( RTK_VOIP_DRIVERS_PCM8186 || RTK_VOIP_GPIO_8962 || RTK_VOIP_DRIVERS_PCM8671 || RTK_VOIP_GPIO_8972B || 	\
						RTK_VOIP_GPIO_8954C_V100 || RTK_VOIP_GPIO_8954C_V200 || RTK_VOIP_GPIO_8954C_V400 ) && !RTK_VOIP_DRIVERS_IP_PHONE
		
		config RTK_VOIP_SLIC_RELAY
			bool "Support SLIC relay (GPIO)"
			default y
			depends on ( RTK_VOIP_DRIVERS_ATA_SLIC ) && ( !RTK_VOIP_GPIO_8954C_V400 )

		# ---------------------------------------------------------------------
		# Sound category - ATA (option)
		
		config RTK_VOIP_DRIVERS_FXO
			bool
			
		config RTK_VOIP_DRIVERS_DAA_SUPPORT
			bool

	if !RTK_VOIP_ETHERNET_DSP_IS_HOST
		# ---------------------------------------------------------------------
		# Sound category - ATA 
		comment "Sound category for ATA/IAD"
		
		config	RTK_VOIP_DRIVERS_ATA_SLIC
			bool "ATA/IAD/SLIC"

		config RTK_VOIP_PULSE_DIAL_GEN_TIMER
			bool 
				#"Pulse Dial Generatiion Support"
			default y
			depends on RTK_VOIP_DRIVERS_DAA_SUPPORT		
		
		# ---------------------------------------------------------------------
		# Sound category - ATA - silab 
	
		config	RTK_VOIP_DRIVERS_SLIC_SILAB
			bool "Silab"
			depends on RTK_VOIP_DRIVERS_ATA_SLIC
			
		#config	RTK_VOIP_DRIVERS_SLIC_SI3210
		#	bool "SI3210"
		#config	RTK_VOIP_DRIVERS_SLIC_SI3215
		#	bool "SI3215"
			
		# ---------------------------------------------------------------------
		# Sound category - ATA - silab - si3217x
		config	RTK_VOIP_DRIVERS_SLIC_SI3217x
			bool "SI3217x"
			depends on RTK_VOIP_DRIVERS_SLIC_SILAB
		
		config	RTK_VOIP_SLIC_SI32176
			bool "SI32176 (Daisy Chain)"
			depends on RTK_VOIP_DRIVERS_SLIC_SI3217x

		config RTK_VOIP_SLIC_SI32176_NR
			int "SI32176 number"
			range 1 16
			depends on RTK_VOIP_SLIC_SI32176 
		
		config RTK_VOIP_SLIC_SI32176_PIN_CS
			int "SI32176 use PIN_CS#"
			range 1 4
			default 1
			depends on RTK_VOIP_SLIC_SI32176 
		
		config	RTK_VOIP_SLIC_SI32178
			bool "SI32178 (Chip Select)"
			depends on RTK_VOIP_DRIVERS_SLIC_SI3217x
		
		config RTK_VOIP_SLIC_SI32178_NR
			int "SI32178 number"
			range 1 16
			depends on RTK_VOIP_SLIC_SI32178 
		
		config RTK_VOIP_SLIC_SI32178_PIN_CS
			int "SI32178 use PIN_CS#"
			range 1 4
			default 1
			depends on RTK_VOIP_SLIC_SI32178 
			
		config	RTK_VOIP_SLIC_SI32176_SI32178
			bool "multiple SI32176 + single SI32178 (Daisy Chain)"
			depends on RTK_VOIP_DRIVERS_SLIC_SI3217x
		
		config	RTK_VOIP_SLIC_SI32176_SI32178_NR
			int "32176 number among multiple SI32176 + single SI32178"
			range 1 16
			depends on RTK_VOIP_SLIC_SI32176_SI32178
		
		config	RTK_VOIP_SLIC_SI32176_SI32178_PIN_CS
			int "multiple SI32176 + single SI32178 use PIN_CS#"
			range 1 4
			default 1
			depends on RTK_VOIP_SLIC_SI32176_SI32178
		
		# ---------------------------------------------------------------------
		# Sound category - ATA - silab - si3226
		
		config	RTK_VOIP_DRIVERS_SLIC_SI3226
			bool "SI3226"
			depends on RTK_VOIP_DRIVERS_SLIC_SILAB
	
		config	RTK_VOIP_SLIC_SI3226_NR
			int "SI3226 number"
			default 1
			depends on RTK_VOIP_DRIVERS_SLIC_SI3226
		
		config	RTK_VOIP_SLIC_SI3226_PIN_CS
			int "SI3226 use PIN_CS#"
			range 1 4
			default 1
			depends on RTK_VOIP_DRIVERS_SLIC_SI3226

		# ---------------------------------------------------------------------
		# Sound category - ATA - silab - additional option & process
	
		config RTK_VOIP_DRIVERS_SI3050
			bool
		
		config  6166_IAD_SILAB3217X
			bool
			depends on RTK_VOIP_GPIO_8672_VQD01 && \
						( RTK_VOIP_SLIC_SI32176 || RTK_VOIP_SLIC_SI32178 || RTK_VOIP_SLIC_SI32176_SI32178 )
		
		config RTK_VOIP_DRIVERS_SILAB_O_OPTION_
			bool
			default y
			depends on RTK_VOIP_SLIC_SI32178 || RTK_VOIP_SLIC_SI32176_SI32178
			select RTK_VOIP_DRIVERS_FXO
			select RTK_VOIP_DRIVERS_SI3050
			select RTK_VOIP_DRIVERS_DAA_SUPPORT		
							
		# ---------------------------------------------------------------------
		# Sound category - ATA - zarlink 
		
		config	RTK_VOIP_DRIVERS_SLIC_ZARLINK
			bool "Zarlink"
			depends on RTK_VOIP_DRIVERS_ATA_SLIC
		
		config	RTK_VOIP_DRIVERS_SLIC_LE88221
			bool "LE88221"
			depends on RTK_VOIP_DRIVERS_SLIC_ZARLINK
		
		config	RTK_VOIP_DRIVERS_SLIC_LE88221_NR
			int "LE88221 number"
			range 1 16
			depends on RTK_VOIP_DRIVERS_SLIC_LE88221
		
		config	RTK_VOIP_DRIVERS_SLIC_LE88221_PIN_CS
			int "LE88221 use PIN_CS#"
			range 1 4
			default 1
			depends on RTK_VOIP_DRIVERS_SLIC_LE88221
			
		config	RTK_VOIP_DRIVERS_SLIC_LE88111
			bool "LE88111"
			depends on RTK_VOIP_DRIVERS_SLIC_ZARLINK
		
		config	RTK_VOIP_DRIVERS_SLIC_LE88111_NR
			int "LE88111 number"
			range 1 16
			depends on RTK_VOIP_DRIVERS_SLIC_LE88111
		
		config	RTK_VOIP_DRIVERS_SLIC_LE88111_PIN_CS
			int "LE88111 use PIN_CS#"
			range 1 4
			default 1
			depends on RTK_VOIP_DRIVERS_SLIC_LE88111
		
		config	RTK_VOIP_DRIVERS_SLIC_LE89116
			bool "LE89116"
			depends on RTK_VOIP_DRIVERS_SLIC_ZARLINK
		
		config	RTK_VOIP_DRIVERS_SLIC_LE89116_NR
			int "LE89116 number"
			range 1 16
			depends on RTK_VOIP_DRIVERS_SLIC_LE89116
		
		config	RTK_VOIP_DRIVERS_SLIC_LE89116_PIN_CS
			int "LE89116 use PIN_CS#"
			range 1 4
			default 1
			depends on RTK_VOIP_DRIVERS_SLIC_LE89116
		
		config	RTK_VOIP_DRIVERS_SLIC_LE89316
			bool "LE89316"
			depends on RTK_VOIP_DRIVERS_SLIC_ZARLINK
			select RTK_VOIP_DRIVERS_FXO
			select RTK_VOIP_DRIVERS_DAA_SUPPORT
		
		config	RTK_VOIP_DRIVERS_SLIC_LE89316_NR
			int "LE89316 number"
			range 1 16
			depends on RTK_VOIP_DRIVERS_SLIC_LE89316
		
		config	RTK_VOIP_DRIVERS_SLIC_LE89316_PIN_CS
			int "LE89316 use PIN_CS#"
			range 1 4
			default 1
			depends on RTK_VOIP_DRIVERS_SLIC_LE89316

		# ---------------------------------------------------------------------
		# Sound category - ATA - zarlink - additional option & process 
				
		config  6166_IAD_ZARLINK
			bool
			depends on RTK_VOIP_GPIO_8672_VQD01 &&	\
						( RTK_VOIP_DRIVERS_SLIC_LE89316 )
		
		config RTK_VOIP_SLIC_ZARLINK_890_SERIES	
			bool
			default y
			depends on RTK_VOIP_DRIVERS_SLIC_LE89116 || RTK_VOIP_DRIVERS_SLIC_LE89316
		
		config RTK_VOIP_SLIC_ZARLINK_880_SERIES	
			bool
			default y
			depends on  RTK_VOIP_DRIVERS_SLIC_LE88111 || RTK_VOIP_DRIVERS_SLIC_LE88221
		
		config RTK_VOIP_DRIVERS_SLIC_ZARLINK_ON_NEW_ARCH
			bool
			default y
			depends on RTK_VOIP_DRIVERS_SLIC_ZARLINK
		
		# ---------------------------------------------------------------------
		# Sound category - ATA - virtual DAA
		
		config	RTK_VOIP_DRIVERS_VIRTUAL_DAA
			depends on !RTK_VOIP_DRIVERS_IP_PHONE && RTK_VOIP_DRIVERS_ATA_SLIC
			bool "VIRTUAL DAA" 
			select RTK_VOIP_DRIVERS_FXO
			select RTK_VOIP_DRIVERS_DAA_SUPPORT
		
		config RTK_VOIP_DRIVERS_VIRTUAL_DAA_2_RELAY_SUPPORT
			depends on RTK_VOIP_DRIVERS_VIRTUAL_DAA
			bool "SUPPORT 2 RELAY"	
		
		# ---------------------------------------------------------------------
		# Sound category - IP Phone 
		
		comment "Sound category for IP Phone"
		
		config	RTK_VOIP_DRIVERS_IP_PHONE
			bool "IP phone"
		
		choice
			prompt "Audio CODEC"
			depends on RTK_VOIP_DRIVERS_IP_PHONE
			default RTK_VOIP_DRIVERS_CODEC_ALC5621
			
			config RTK_VOIP_DRIVERS_CODEC_ALC5621
				bool "Realtek ALC5621"
			
			#config RTK_VOIP_DRIVERS_CODEC_WM8510
			#	bool "Wolfson WM8510"
		endchoice
		
		config RTK_VOIP_IP_PHONE
			bool
			depends on RTK_VOIP_DRIVERS_IP_PHONE
			default y
		
		config RTK_VOIP_IP_PHONE_CH_NR
			int 
			depends on RTK_VOIP_DRIVERS_IP_PHONE
			default 1
		
		# ---------------------------------------------------------------------
		# Sound category - DECT  
		
		comment "Sound category for ATA/DECT"
		
		config	RTK_VOIP_DRIVERS_ATA_DECT
			bool "ATA/DECT"
		
		choice
			prompt "Interface"
			depends on RTK_VOIP_DRIVERS_ATA_DECT
			default RTK_VOIP_DECT_UART_SUPPORT
			
			config RTK_VOIP_DECT_UART_SUPPORT
				bool "UART"
			config RTK_VOIP_DECT_SPI_SUPPORT
				bool "SPI"
		endchoice

		choice
			prompt "DECT Module"
			depends on RTK_VOIP_DRIVERS_ATA_DECT
			default RTK_VOIP_DECT_DSPG_SUPPORT

			config RTK_VOIP_DECT_DSPG_SUPPORT
				bool "DSPG CMBS Module"
				depends on RTK_VOIP_DECT_UART_SUPPORT
			
			config RTK_VOIP_DECT_SITEL_SUPPORT
				bool "SiTEL CVM480 Module"
				depends on RTK_VOIP_DECT_SPI_SUPPORT
			
		endchoice
		
		config RTK_VOIP_DECT_UART_BAUD_RATE
			int "DECT UART Baudrate"
			default 115200
			depends on RTK_VOIP_DECT_UART_SUPPORT && RTK_VOIP_DECT_DSPG_SUPPORT
			help
				Valid values are 9600/14400/19200/38400/57600/115200

		config RTK_VOIP_DECT_DSPG_UART_HW_FLOW_CTRL
			bool "DECT UART Flow Control Support"
			depends on RTK_VOIP_DECT_DSPG_SUPPORT && RTK_VOIP_DECT_UART_SUPPORT
			
		config RTK_VOIP_DECT_DSPG_HS_NR
			#int "DSPG handset number"
			#range 1 4
			int
			default 1
			depends on RTK_VOIP_DECT_DSPG_SUPPORT
				
		config RTK_VOIP_DECT_SITEL_HS_NR
			int "SiTEL handset number"
			range 1 4
			depends on RTK_VOIP_DECT_SITEL_SUPPORT

		#config RTK_VOIP_DRIVERS_11N_MP
		#	depends on RTL8196B
		#	bool "11N MP Test"		
		
		# ---------------------------------------------------------------------
		# PCM/IIS Bus
		
		comment "Bus configuration"

		config RTK_VOIP_DRIVERS_PCM
			bool "Support PCM bus"
			default y if !RTK_VOIP_DRIVERS_IIS
		
		config RTK_VOIP_BUS_PCM_CH_NUM
			int "PCM bus channel number"
			default 4
			range 1 8
			depends on RTK_VOIP_DRIVERS_PCM
		
		config RTK_VOIP_DRIVERS_IIS
			bool "Support IIS bus"
			depends on RTK_VOIP_DRIVERS_PCM8972B_FAMILY || RTK_VOIP_DRIVERS_PCM89xxC
		
		config RTK_VOIP_BUS_IIS_CH_NUM
			#int "IIS bus channel number"
			int
			default 1
			range 1 1
			depends on RTK_VOIP_DRIVERS_IIS
		
		# ---------------------------------------------------------------------
		# Application options 
		
		comment "Application options"

		config RTK_VOIP_WIDEBAND_APP
			bool "Wideband application"
			default n
			depends on RTK_VOIP_WIDEBAND_SUPPORT && !AUDIOCODES_VOIP
			help
				RTK_VOIP_WIDEBAND_SUPPORT is for DSP, and this one is 
				for bus (PCM/IIS) and snd (SLIC/AC). 
		
		config RTK_VOIP_CON_CH_NUM
			int "Control channel number"
			range 1 32
			help
				Normally, this value is equal to port number. 
				Take an example, '89xxC V200' has two FXS and one FXO ports, so 
				three will be assigned. 
				DECT application depends on handset number and PCM channel requirement, and 
				we suggest four to this value. 

	endif 		
		# ---------------------------------------------------------------------
		# DSP
		
		comment "DSP options"
		
		config AUDIOCODES_VOIP_
			bool 
			default y
			depends on RTK_VOIP_DRIVERS_PCM8981B_ || RTK_VOIP_DRIVERS_PCM8982B_ || RTK_VOIP_DRIVERS_PCM8984B_ ||	\
							RTK_VOIP_DRIVERS_PCM8961C_ || RTK_VOIP_DRIVERS_PCM8962C_ || RTK_VOIP_DRIVERS_PCM8964C_ || RTK_VOIP_DRIVERS_PCM8672
		
		choice
			prompt "DSP package" 
			default AUDIOCODES_VOIP if AUDIOCODES_VOIP_
		
			config REALTEK_VOIP_
				bool "Realtek"
			
			config AUDIOCODES_VOIP
				bool "Audiocodes"
				depends on AUDIOCODES_VOIP_
		endchoice

		config AUDIOCODES_VOIP_RELEASE
			bool
			default y
			depends on AUDIOCODES_VOIP
		
		config	RTK_VOIP_IVR
			bool "IVR instructions"
			select RTK_VOIP_IVR_TEXT
			select RTK_VOIP_IVR_LINEAR_8K
			select RTK_VOIP_IVR_DEV
		config	RTK_VOIP_IVR_DEV
			bool 
		config	RTK_VOIP_IVR_TEXT
			bool 
		config	RTK_VOIP_IVR_LINEAR_8K
			bool 
		#config	RTK_VOIP_IVR_LINEAR_16K
		#	bool "Linear 16kHz"

		# ---------------------------------------------------------------------
		# DSP - codec  
		
		comment "Speech CODECs"
		config	RTK_VOIP_G729AB
			bool "G.729AB"
		config	RTK_VOIP_G7231
			bool "G.723.1"
		config	RTK_VOIP_AMR_NB
			bool "AMR-NB"
			depends on !RTK_VOIP_DRIVERS_PCM8981B_ && !RTK_VOIP_DRIVERS_PCM8982B_ && !RTK_VOIP_DRIVERS_PCM8984B_ && !VOIP_SDK
		config	RTK_VOIP_RTK_VOIP_SPEEX_NB
			bool "SPEEX-NB"
			depends on !RTK_VOIP_DRIVERS_PCM8981B_ && !RTK_VOIP_DRIVERS_PCM8982B_ && !RTK_VOIP_DRIVERS_PCM8984B_ && !VOIP_SDK
		config 	RTK_VOIP_G726
			bool "G.726"
			depends on !RTK_VOIP_DRIVERS_PCM8186VA_ && !RTK_VOIP_DRIVERS_PCM8651BV_ && !RTK_VOIP_DRIVERS_PCM8651CVA_ && !RTK_VOIP_DRIVERS_PCM8671VA_ && !RTK_VOIP_DRIVERS_PCM8981B_ && !RTK_VOIP_DRIVERS_PCM8982B_ && !RTK_VOIP_DRIVERS_PCM8984B_ && !RTK_VOIP_DRIVERS_PCM8961C_ && !RTK_VOIP_DRIVERS_PCM8962C_ && !RTK_VOIP_DRIVERS_PCM8964C_
		config	RTK_VOIP_GSMFR
			bool "GSM-FR"
			depends on !RTK_VOIP_DRIVERS_PCM8186VA_ && !RTK_VOIP_DRIVERS_PCM8651BV_ && !RTK_VOIP_DRIVERS_PCM8651CVA_ && !RTK_VOIP_DRIVERS_PCM8671VA_ && !RTK_VOIP_DRIVERS_PCM8981B_ && !RTK_VOIP_DRIVERS_PCM8982B_ && !RTK_VOIP_DRIVERS_PCM8984B_ && !RTK_VOIP_DRIVERS_PCM8961C_ && !RTK_VOIP_DRIVERS_PCM8962C_ && !RTK_VOIP_DRIVERS_PCM8964C_
		config  RTK_VOIP_ILBC
			bool 'iLBC' 
			depends on !RTK_VOIP_DRIVERS_PCM8186VA_ && !RTK_VOIP_DRIVERS_PCM8651BV_ && !RTK_VOIP_DRIVERS_PCM8651CVA_ && !RTK_VOIP_DRIVERS_PCM8671VA_ && !RTK_VOIP_DRIVERS_PCM8981B_ && !RTK_VOIP_DRIVERS_PCM8982B_ && !RTK_VOIP_DRIVERS_PCM8984B_ && !RTK_VOIP_DRIVERS_PCM8961C_ && !RTK_VOIP_DRIVERS_PCM8962C_ && !RTK_VOIP_DRIVERS_PCM8964C_
		config	RTK_VOIP_G722
			bool "G.722"
			depends on !RTK_VOIP_DRIVERS_PCM8186VA_ && !RTK_VOIP_DRIVERS_PCM8651BV_ && !RTK_VOIP_DRIVERS_PCM8651CVA_ && !RTK_VOIP_DRIVERS_PCM8671VA_ && !RTK_VOIP_DRIVERS_PCM8981B_ && !RTK_VOIP_DRIVERS_PCM8982B_ && !RTK_VOIP_DRIVERS_PCM8984B_ && !RTK_VOIP_DRIVERS_PCM8961C_ && !RTK_VOIP_DRIVERS_PCM8962C_ && !RTK_VOIP_DRIVERS_PCM8964C_
		config	RTK_VOIP_T38
			bool "T.38 (FAX)"
		
		config	RTK_VOIP_SILENCE
			bool
			default y

		# ---------------------------------------------------------------------
		# Protocol and Security 
		
		comment "Protocol and Security"

		config RTK_VOIP_RTCP_XR
			bool "Enable RTCP XR (RFC3611)"
			depends on REALTEK_VOIP_

		config RTK_VOIP_SRTP
			bool "Enable SRTP"
		
		config RTK_VOIP_SIP_TLS
			bool "Enable SIP TLS"
	
		# ---------------------------------------------------------------------
		# Network 
		
		comment "Network"
		config RTK_VOIP_PORT_LINK
			bool "Port Link Monitor"

		choice
			prompt "Gigabyte Phy Link Mode"
			depends on RTK_VOIP_DRIVERS_PCM89xxC
			default RTK_VOIP_GIGABYTE_PHY_LINK_MODE_NORMAL

			config RTK_VOIP_GIGABYTE_PHY_LINK_MODE_NORMAL
				bool "10/100/1000"
			config RTK_VOIP_GIGABYTE_PHY_LINK_MODE_100
				bool "10/100"
		endchoice
	
		config RTK_VOIP_QOS
			bool "Enable QoS for VoIP"
			depends on (RTK_VOIP_DRIVERS_PCM8972B_FAMILY || \
						RTK_VOIP_GPIO_8954C_V100 || \
						RTK_VOIP_GPIO_8954C_V200 || \
						RTK_VOIP_GPIO_8954C_V400)

		config RTK_VOIP_865xC_QOS
			bool
		config RTK_VOIP_WAN_VLAN
			bool
		config RTK_VOIP_QOS
			bool
		config RTK_VOIP_QOS_HEAVYLOAD
			bool
		
	endif	
endmenu
```
