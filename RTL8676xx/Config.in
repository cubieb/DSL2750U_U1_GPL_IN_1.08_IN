## RTL8676xx/Config.in
```kconfig
#############################################################################
#
# NOTE : it is fairly important that changes to this file consider their
#        effect on other platforms and default setups.  If you can, only
#        add to the file,  changing the name of a variable will break
#        many configurations.
#
#
#############################################################################

mainmenu "T&W Broadband System Configuration"

#############################################################################

comment 'TBS Board Configuration'
choice
	prompt "Chipset Type"
config RTL8676_BOARD
	bool "RTL8676(REALTEK)"
	select MIPS
	select ARCH_CPU_EB
	select CPU_BIG_ENDIAN
	select ARCH_32BIT
	select SYS_SUPPORTS_32BIT_KERNEL
	select CPU_SUPPORTS_32BIT_KERNEL
	select 32BIT
	select ARCH_CPU_RLX5281
	select CPU_RLX5281
	select RTL8676
config VRX288
	bool "VRX288(LANTIQ)"
	select VR9
config UML
    	bool UML 
config AR7130
    	bool "AR7130(ATHEROS)"
config	AMASON_SE 
	bool "AMASON_SE(INFINEON)"
config RT3052
	bool "RT3052(RALINK)"
config VX180
	bool "Vx180(IKANOS)"
config C1000 
	bool "C1000(MindSpeed)"
config RTL8672_BOARD
        bool "RTL8672(REALTEK)"
endchoice

source BoardConfig.in      
comment 'TBS Source Code Configuration'

source apps/Config.debug.in

config TBS_SUPPORT_SWITCH_VLAN
    bool "TBS Support Switch Vlan"
    default y
    help
      Setting TBS Support Switch Vlan

config TBS_SUPPORT_IPV6
	bool "TBS Support IPV6"
	default n
	select APPS_LOGIC_SUPPORT_IPV6
	help
	  Setting TBS whether or not to support ipv6

config RTL8673
    bool "TBS RTL8673"
    default n
    help
      RTL8673 support
	  
config TBS_MASSIVE_UPGRADE
        bool "TBS Massive upgrade tool support"
	default n
	help
	  Setting TBS whether or not to support Massive upgrade. Enable this will cost more 6 seconds when boot.


config TBS_APPS_SECURITY
	bool 'TBS_APPS SECURITY'
	default n
    help
	  TBS APPS Security.
	  
config APPS_TELNET_VERIFICATION
	bool 'Telnet_Verification'
	default n
	depends on TBS_APPS_SECURITY
    help
	  Support Telnet verifictation.

config APPS_WEB_DIRECTURL_ACCESS
	bool 'WEB_DirectURL access'
	default n
	depends on TBS_APPS_SECURITY
    help
	  Support WEB_DirectURL access.	  
	  	           
config TBS_BACKUP_ENCRYPTION
	bool 'TBS BACKUP ENCRYPTION'
	default n
	depends on TBS_APPS_SECURITY
	help
		Support backup encryption.	  
	  
#source hal/Config.in      
#source boot/Config.in
source apps/Config.in
source opensource/Config.in
source vendor/Config.in
source driver/Config.in      
comment 'Linux Kernel Configuration'
source kernel/Config.in
```

## RTL8676xx/src/apps/Config.in
```kconfig
######################################
#
#
######################################
menuconfig APPS
  bool "Applications"
  default y

source apps/ssap/Config.in  
source apps/logic/Config.in  

source apps/ipv6/Config.in
config APPS_CLI
	bool 'CLI'
	default y
	depends on APPS
  	help 
      	CLI(Command Line Interface)

config APPS_CLI_SEPARATE_AUTH
	bool 'CLI authenticate from MTD'
	default n
	depends on APPS_CLI
	help
		CLI authenticate from MTD replace from config

menu "TR069FE"
	depends on APPS
	config APPS_TR069
		bool 'TR069'
		default n
		depends on APPS_LOGIC_TR069 && APPS
		help
		TR069FE
source apps/tr069fe/Config.in
endmenu

menu "TR064FE"
    depends on APPS
    config APPS_TR064
		bool 'TR064'
		default n
		depends on APPS_LOGIC_TR064BE && APPS
		help
		TR064FE
source apps/tr064fe/Config.in
endmenu
      
config APPS_WEB
	bool 'WEB'
	default y
	depends on APPS
	select OPENSOURCE_HTTPD
  	help
      	WEB       

source apps/html/Config.in

config APPS_TM
        bool 'TM'
        default n
        depends on APPS
        help
        TM
config APPS_UPGCGI
	boolean "upgcgi"
	default n
	depends on APPS
	help
	CGI upg
source apps/supp/Config.in

source apps/logic/new3g/Config.in
source apps/captival-portal/Config.in
```

## RTL8676xx/src/apps/captival-portal/Config.in
```kconfig
#scb+ 2011-10-19
######################################
config APPS_GENERAL_CAPTIVAL_PORTAL
	bool 'GENERAL_CAPTIVAL_PORTAL'
	default n
	depends on APPS
  	help
      	  This program is for implement the captival portal function
######################################
```

## RTL8676xx/src/apps/ipv6/Config.in
```kconfig
menuconfig APPS_IPV6
        bool 'IPV6'
        default y
        depends on APPS  && TBS_SUPPORT_IPV6
        help
        IPV6

config APPS_IPV6_RAMON
	bool 'RAMon'
	default y
	depends on APPS_IPV6
	help
		used for monitoring RA message

config APPS_IPV6_IP6MON
	bool 'IP6Mon'
	default y
	depends on APPS_IPV6
	help
		used for monitoring IPv6 address and default route status change

config APPS_IPV6_IP6AAC
	bool 'IP6AAC'
	default y
	depends on APPS_IPV6
	help
		used for IPv6 address autoconfiguration, including stateful and stateless


config APPS_IPV6_IFIPV6
	bool 'ifip6'
	default y
	depends on APPS_IPV6
	help
		used for enable or disable ipv6 for individual interface
```

## RTL8676xx/src/apps/ssap/Config.in
```kconfig
menuconfig APPS_SSAP
	bool 'SSAP'
	default y
	depends on APPS
  	help
      	SSAP


config APPS_SSAP_BUTTON
	bool 'Button'
	default n
	depends on APPS_SSAP
	help
		Button module	
	
config APPS_SSAP_PROTEST
	bool 'Product test'
	default n
	depends on APPS_SSAP
	help
		Product test module	

config APPS_SSAP_UPGRADE
	bool 'Upgrade'
	default y
	depends on APPS_SSAP
	help
		Upgrade module	

config APPS_SSAP_TFTPUPG
    bool 'tftp_upg'
    default y
    depends on APPS_SSAP_UPGRADE
    help
       For tftp upgrade 

config APPS_SSAP_GETSMAPS
    bool 'getsmaps'
	depends on APPS_SSAP
    default n
    help
        For test only,the progress can count a process's memory 

config APPS_SSAP_RCDMODULETM
    bool 'record module time'
	depends on APPS_SSAP
    default n
    help
        For test only,the progress can count time of logic's module calling function 

config APPS_CMM_NODE_FIX
    bool 'Check and restore the missing node'
    depends on APPS_SSAP
    default n
    help
        Restore the missing node at boot-up after upgrade to the new firmware.
```

## RTL8676xx/src/apps/supp/Config.in
```kconfig
#####################
config APPS_SUPP
	bool '802.1x supplicant'
	default n
	depends on APPS
	help 
      	Enable 802.1x supplicant 
```

## RTL8676xx/src/apps/tr064fe/Config.in
```kconfig
config ALP_CC_TR064FE
	bool 'TR064FE'
	default y
	depends on APPS
  	help 
        tr064 front end
```

## RTL8676xx/src/apps/tr069fe/Config.in
```kconfig
config ALP_CC_TR069FE
	bool 'TR069FE'
	default y
	depends on APPS_LOGIC_TR069
  	help 
        tr069 front end

config  TR069_SSL
	bool 'Support TR069 SSL'
	default y
	depends on APPS_LOGIC_TR069 && OPENSOURCE_OPENSSL
	help 
        tr069 support ssl

config  TR069_PRINT_PACKAGE_TO_FILE
	bool 'Print Package to file(for DEBUG)'
	default n
        depends on ALP_CC_TR069FE
	help
	Print Package to file /var/tmp/tr069_package.(for DEBUG)

config  TR069_CN_CHECK
	bool 'Support TR069 CN CHECK'
	default n
	depends on APPS_LOGIC_TR069 && OPENSOURCE_OPENSSL
	help 
        tr069 support common name check
```

## RTL8676xx/src/driver/Config.in
```kconfig
menuconfig DRIVERS
	bool 'Drivers'
	default y
	help 
	Driver

source driver/wireless/Config.in
source driver/dsl/Config.in
```

## RTL8676xx/src/driver/dsl/Config.in
```kconfig
menuconfig	DRIVERS_DSL
	bool 'Dsl Drivers'
	default n
	depends on DRIVERS
	help
		DSL device driver module

config INFINEON_DSL_DRIVERS
	bool 'Infineon dsl driver'
	depends on DRIVERS_DSL && AMAZON_SE && AMAZON_SE_MEI_BSP
	help
		Infineon dsl driver

config IKANOS_DSL_DRIVERS
	bool 'IKANOS xDSL driver'
	depends on DRIVERS_DSL && VX180
	help
		IKANOS xDSL driver

config RTL8672_DSL_DRIVERS
	bool 'RTL8672 xDSL driver'
	depends on DRIVERS_DSL && RTL8672_BOARD
	help
		RTL8672 xDSL driver
```
